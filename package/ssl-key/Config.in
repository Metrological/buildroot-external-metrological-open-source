## package/westeros/westeros-simplebuffer/Config.in
```kconfig
config BR2_PACKAGE_WESTEROS_SIMPLEBUFFER
	bool "westeros-simplebuffer"
	depends on BR2_PACKAGE_WESTEROS_SIMPLE_PROTOCOL
	select BR2_PACKAGE_WAYLAND
	select BR2_PACKAGE_WAYLAND_PROTOCOLS
	select BR2_PACKAGE_LIBGLIB2
	help
	  Buffer allocator based on shared memory.

	  https://code.rdkcentral.com/r/components/opensource/westeros

comment "westeros-simplebuffer needs simple buffer protocol"
		depends on !BR2_PACKAGE_WESTEROS_SIMPLE_PROTOCOL
```
