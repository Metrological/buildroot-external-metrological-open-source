## package/thunder/Config.in
```kconfig
# WPE Framework
source "$BR2_EXTERNAL_ML_OSS_PATH/package/thunder/thunder/Config.in"

# WPE Framework Generators
source "$BR2_EXTERNAL_ML_OSS_PATH/package/thunder/thunder-tools/Config.in"

# WPE WebKit
#source "$BR2_EXTERNAL_ML_OSS_PATH/package/thunder/wpewebkit-ml/Config.in"

if BR2_PACKAGE_WPEWEBKIT
#source "$BR2_EXTERNAL_ML_OSS_PATH/package/thunder/wpebackend-ml/Config.in"
#source "$BR2_EXTERNAL_ML_OSS_PATH/package/thunder/wpebackend-rdk/Config.in"
endif
```

## package/thunder/thunder-avnclient/Config.in
```kconfig
config BR2_PACKAGE_THUNDER_AVNCLIENT
	bool "AVNClient"
	depends on BR2_PACKAGE_AVN_CLIENT
	help
	   WPE Platform AVNClient plugin
```

## package/thunder/thunder-clientlibraries/Config.in
```kconfig
config BR2_PACKAGE_THUNDER_CLIENTLIBRARIES
    bool
    help
        Collection of libraries to make life easier intergrating thunder
        in external componenets.

comment "External extensions"

config BR2_PACKAGE_THUNDER_CDM
    select BR2_PACKAGE_THUNDER_CLIENTLIBRARIES
    bool "ContentDecryptionModule"
    help
      CDM client support compatible with OpenCDM

config BR2_PACKAGE_THUNDER_COMPOSITORCLIENT
    select BR2_PACKAGE_THUNDER_CLIENTLIBRARIES
    bool "CompositorClient"
    default y
    help
      A graphical/input abstraction. This library is included in micro services that requires user
          interaction (Graphics/input). The implementation hides all the compositor specific details.
      allows for relaying keys to plugins

#"GstreamerClient (deprecated)"
config BR2_PACKAGE_THUNDER_GSTREAMERCLIENT
    select BR2_PACKAGE_THUNDER_CLIENTLIBRARIES
    bool 
    default n
    help
        Gstreamer client provides custom APIs to manipulate underneath stream sinks which will be linked with created pipeline.
        This implementation will vary based on custom platforms and sink backends.

config BR2_PACKAGE_THUNDER_DISPLAYINFO
    select BR2_PACKAGE_THUNDER_CLIENTLIBRARIES
    bool "DisplayInfo"
    default y
    help
        A helpful C-interface to easily get information from the DisplayInfo plugin.

config BR2_PACKAGE_THUNDER_CRYPTOGRAPHY
#    select BR2_PACKAGE_THUNDER_CLIENTLIBRARIES
    bool "Cryptography"
    default n
    help
        Abstraction on generic cryptography functionality.

    if BR2_PACKAGE_THUNDER_CRYPTOGRAPHY
    choice BR2_PACKAGE_THUNDER_CRYPTOGRAPHY_BACKEND
        prompt "backend"
        default BR2_PACKAGE_THUNDER_CRYPTOGRAPHY_BACKEND_OPENSSL
        help
            Choose an crypography backend

        config BR2_PACKAGE_THUNDER_CRYPTOGRAPHY_BACKEND_THUNDER
            bool "Thunder"
            help
                Use Thunder as cryptography backend.

        config BR2_PACKAGE_THUNDER_CRYPTOGRAPHY_BACKEND_PROVISIONING
            bool "Provisioning"
            select BR2_PACKAGE_THUNDER_PROVISIONPROXY
            help
                Use provisioning/OpenSSL as cryptography backend.

        config BR2_PACKAGE_THUNDER_CRYPTOGRAPHY_BACKEND_OPENSSL
            bool "OpenSSL"
            select BR2_PACKAGE_OPENSSL
            help
                Use OpenSSL as cryptography backend.

        config BR2_PACKAGE_THUNDER_CRYPTOGRAPHY_BACKEND_NEXUS
            bool "Nexus"
            depends on BR2_PACKAGE_HAS_NEXUS
            help
                Use Nexus as cryptography backend.
    endchoice
    endif

config BR2_PACKAGE_THUNDER_SECURITYAGENT_ACCESSOR
    bool "SecurityAgent"
    select BR2_PACKAGE_THUNDER_CLIENTLIBRARIES
    help
        Allows external access to the Security Agent, through a C interface.

config BR2_PACKAGE_THUNDER_VIRTUALINPUT
    bool "VirtualInput"
    select BR2_PACKAGE_THUNDER_CLIENTLIBRARIES
    help
      If the dynamic uinput system can not be used for security reasons, this
      allows for relaying keys to plugins

config BR2_PACKAGE_THUNDER_PROVISIONPROXY
    bool "ProvisionProxy"
    select BR2_PACKAGE_THUNDER_CLIENTLIBRARIES
    select BR2_PACKAGE_LIBPROVISION
    help
      Allows provisioning of modules from the cloud.
```

## package/thunder/thunder-playgiga/Config.in
```kconfig
config BR2_PACKAGE_THUNDER_PLAYGIGA
	bool "PlayGiga"
	depends on BR2_PACKAGE_PLAYGIGA
	help
	   WPE Platform PlayGiga plugin
```

## package/thunder/thunder-rdkservices/Config.in
```kconfig
config BR2_PACKAGE_THUNDER_RDKSERVICES
    bool

choice
    bool "Site for rdk plugins"
    default THUNDER_RDKSERVICES_SITE_RDKCENTRAL
    help
        Choose the site where to get the rdk plugin sources.

    config THUNDER_RDKSERVICES_SITE_RDKCENTRAL
            bool "rdkcentral"

    config THUNDER_RDKSERVICES_SITE_WEBPLATFORMFOREMBEDDED
            bool "WebPlatformForEmbedded"

endchoice
```

## package/thunder/thunder-spotify/Config.in
```kconfig
config BR2_PACKAGE_THUNDER_SPOTIFY
	bool "Spotify"
	select BR2_PACKAGE_ALSA_LIB
	help
	   WPE Platform plugins that supports spotify services.
            - Spotify connect

if BR2_PACKAGE_THUNDER_SPOTIFY
# options for the plugin
endif
```

## package/thunder/thunder-switchboard/Config.in
```kconfig
config BR2_PACKAGE_THUNDER_SWITCHBOARD
	bool "SwitchBoard"
	help
	   WPE Platform Switch Board plugin
```

## package/thunder/thunder-ui/Config.in
```kconfig
config BR2_PACKAGE_THUNDER_UI
    bool "UI"
    default y
    depends on BR2_PACKAGE_THUNDER
    help
        WPE Framework User Interface for development and testing
```

## package/thunder/thunder/Config.in
```kconfig
config BR2_PACKAGE_THUNDER
    bool "thunder"
    select BR2_PACKAGE_THUNDER_TOOLS
    select BR2_PACKAGE_LIBZLIB
    help
      WPE Framework

if BR2_PACKAGE_THUNDER

menu "options"
    choice BR2_PACKAGE_THUNDER_BUILD_TYPE
        prompt "Build type"
        default BR2_PACKAGE_THUNDER_BUILD_TYPE_RELEASE
        help
        Select the type of build you want to use.

    config BR2_PACKAGE_THUNDER_BUILD_TYPE_DEBUG
        bool "Debug"
        help
        This build type is with: traces, callstacks, symbols, asserts; without: optimizations.

    config BR2_PACKAGE_THUNDER_BUILD_TYPE_DEBUG_OPTIMIZED
        bool "Debug optimized"
        help
        This build type is with: traces, callstacks, symbols, asserts.

    config BR2_PACKAGE_THUNDER_BUILD_TYPE_RELEASE_WITH_SYMBOLS
        bool "Release with symbols"
        help
        This build type is with: callstacks, symbols; without: asserts, traces.

    config BR2_PACKAGE_THUNDER_BUILD_TYPE_RELEASE
        bool "Release"
        help
        This build type is with: callstacks; without: asserts, traces, symbols.

    config BR2_PACKAGE_THUNDER_BUILD_TYPE_PRODUCTION
        bool "Production"
        help
        This build type is without: traces, callstacks, symbols, asserts.

    endchoice

    config BR2_PACKAGE_THUNDER_CREATE_IPKG_TARGETS
        bool "create ipkg targets"
        select BR2_PACKAGE_HOST_OPKG_UTILS
        depends on BR2_PACKAGE_THUNDER_PACKAGER
        help
            Creates from configured targets, a DEBIAN 2.0 (ipk, opk, deb) packages. Configured packages will install theirs
            staging file, but not target files on the root filesystem

    config BR2_PACKAGE_THUNDER_PORT
        string "port"
        default "80"

    config BR2_PACKAGE_THUNDER_BIND
        string "bind"
        default "0.0.0.0"

    config BR2_PACKAGE_THUNDER_INTERFACE
        string "interface"
        default ""

    config BR2_PACKAGE_THUNDER_IDLE_TIME
        string "idle-time"
        default "180"

    config BR2_PACKAGE_THUNDER_PERSISTENT_PATH
        string "persistent path"
        default "/root"

    config BR2_PACKAGE_THUNDER_VOLATILE_PATH
        string "volatile path"
        default "/tmp"

    config BR2_PACKAGE_THUNDER_DATA_PATH
        string "data path"
        default "/usr/share/WPEFramework"

    config BR2_PACKAGE_THUNDER_SYSTEM_PATH
        string "system path"
        default "/usr/lib/thunder/plugins"

    config BR2_PACKAGE_THUNDER_PROXYSTUB_PATH
        string "proxystub path"
        default "/usr/lib/thunder/proxystubs"

    config BR2_PACKAGE_THUNDER_TRACE_SETTINGS
        string "trace settings"
        default ""

    config BR2_PACKAGE_THUNDER_OOM_ADJUST
        string "oom-adjust"
        default ""

    config BR2_PACKAGE_THUNDER_SYSTEM_PREFIX
        string "system prefix"
        default ""

    config BR2_PACKAGE_THUNDER_EXCEPTIONS_ENABLE
        bool "exceptions on"
        default n

    config BR2_PACKAGE_THUNDER_PERFORMANCE_MONITOR
        bool "performance monitor on"
        default n

    config BR2_PACKAGE_THUNDER_WARNING_REPORTING
        bool "DefensiveWarnings"
        default n
        help
        Add a defensive warning system to the Thunder. It increases the footprint
        of the Thunder application but it allows for profiling and early warning
        on misbahving plugins. This feature should be used at least once before
        creating a production build to get a feeling on the behaviour of new
        plugins. They should not raise any warnings here !!!

    config BR2_PACKAGE_THUNDER_EXCEPTION_CATCHING
        bool "ExceptionCatching"
        default n
        help
        Some plugins are developed with Exception handling turned on. If an exception
        is not caught in the plugin it ends up in the framework. This feature tries
        to recover from these uncaught execptions. If it happens on a workerpool thread
        the framework will catch it, report it and continue. If the exception is thrown
        from a thread not under control of the framework it reports and shutsdown the
        framework. There is no possibility to recover from it.

    source "$BR2_EXTERNAL_ML_OSS_PATH/package/thunder/thunder-devtools/Config.in"

endmenu

menu "extensions"
comment "Build-in extensions"

config BR2_PACKAGE_THUNDER_BROADCAST
    bool "Broadcast"
        default n
    help
      Abstraction on QAM tuner and PSI/SI parser functionality.

    if BR2_PACKAGE_THUNDER_BROADCAST
    config BR2_PACKAGE_THUNDER_BROADCAST_SI_PARSING
        bool "SI Parsing"
            default n
        help
        Enable functionality to automatically parse SI information on the
            tuned streams.
    endif

config BR2_PACKAGE_THUNDER_PROCESSCONTAINERS
    bool "Process Containers"
        default n
    help
      Enable ability to start a containerized nanoservices

    if BR2_PACKAGE_THUNDER_PROCESSCONTAINERS
    choice BR2_PACKAGE_THUNDER_PROCESSCONTAINERS_BACKEND
        prompt "Containers backend"
        default BR2_PACKAGE_THUNDER_PROCESSCONTAINERS_BACKEND_LXC
        help
            Select which container framework to use as a backend

    config BR2_PACKAGE_THUNDER_PROCESSCONTAINERS_BACKEND_LXC
        bool "LXC"
        select BR2_PACKAGE_LXC
        select BR2_PACKAGE_CGROUPFS_MOUNT

    config BR2_PACKAGE_THUNDER_PROCESSCONTAINERS_BACKEND_RUNC
        bool "RunC"
        select BR2_PACKAGE_RUNC
        select BR2_PACKAGE_CGROUPFS_MOUNT

    config BR2_PACKAGE_THUNDER_PROCESSCONTAINERS_BACKEND_CRUN
        bool "CRun"
        select BR2_PACKAGE_CRUN
        select BR2_PACKAGE_CGROUPFS_MOUNT
    endchoice
    endif

config BR2_PACKAGE_THUNDER_SECURE_SOCKET
    bool "SecureSocket"
    select BR2_PACKAGE_OPENSSL
    help
      Adds a Secure Socket implementation (dependency OpenSSL)

#"Init.d script from package config (deprecated)"
config BR2_PACKAGE_THUNDER_INSTALL_INITD_DEPRECATED
    bool 
    help
      Install thunder config file from buildroot package config folder"

source "$BR2_EXTERNAL_ML_OSS_PATH/package/thunder/thunder-clientlibraries/Config.in"
endmenu

menu "plugins"
source "$BR2_EXTERNAL_ML_OSS_PATH/package/thunder/thunder-plugins/Config.in"
source "$BR2_EXTERNAL_ML_OSS_PATH/package/thunder/thunder-amazon/Config.in"
source "$BR2_EXTERNAL_ML_OSS_PATH/package/thunder/thunder-avs/Config.in"
source "$BR2_EXTERNAL_ML_OSS_PATH/package/thunder/thunder-avnclient/Config.in"
source "$BR2_EXTERNAL_ML_OSS_PATH/package/thunder/thunder-launcher/Config.in"
source "$BR2_EXTERNAL_ML_OSS_PATH/package/thunder/thunder-netflix/Config.in"
source "$BR2_EXTERNAL_ML_OSS_PATH/package/thunder/thunder-playgiga/Config.in"
source "$BR2_EXTERNAL_ML_OSS_PATH/package/thunder/thunder-provisioning/Config.in"
source "$BR2_EXTERNAL_ML_OSS_PATH/package/thunder/thunder-spotify/Config.in"
source "$BR2_EXTERNAL_ML_OSS_PATH/package/thunder/thunder-switchboard/Config.in"
source "$BR2_EXTERNAL_ML_OSS_PATH/package/thunder/thunder-ui/Config.in"
endmenu

source "$BR2_EXTERNAL_ML_OSS_PATH/package/thunder/thunder-interfaces/Config.in"
source "$BR2_EXTERNAL_ML_OSS_PATH/package/thunder/thunder-rdkservices/Config.in"

endif
```

## package/westeros/Config.in
```kconfig
menuconfig BR2_PACKAGE_WESTEROS
	bool "westeros"
	select BR2_PACKAGE_WAYLAND
	select BR2_PACKAGE_WAYLAND_PROTOCOLS
	select BR2_PACKAGE_LIBXKBCOMMON
	select BR2_PACKAGE_XKEYBOARD_CONFIG
	select BR2_PACKAGE_WESTEROS_SOC
	help
	  Westeros is an open source Wayland compositor library that allows
	  applications to create Wayland displays including embedded
	  Wayland displays

	  https://code.rdkcentral.com/r/components/opensource/westeros

if BR2_PACKAGE_WESTEROS
	config BR2_PACKAGE_WESTEROS_RENDERER_GL
		bool "renderer gl"
		default y
		help
			Enable OpenGL renderer support for westeros compositor

	config BR2_PACKAGE_WESTEROS_ESSOS
		bool "essos"
		help
			Essos is a library making it simple to create applications that run either 
			as native EGL or Wayland clients.  It is a companion to Westeros compositor.
	
	config BR2_PACKAGE_WESTEROS_HAS_XDG_SHELL
		bool
		default n
	
	choice
		prompt "xdg-shell protocol"
		default BR2_PACKAGE_WESTEROS_XDG_SHELL_PROTOCOL_V5
		help
			Enable xdg-shell protocol support for Westeros compositor

	config BR2_PACKAGE_WESTEROS_XDG_SHELL_DISABLE
		bool "disable"
		help
			Disable xdg-shell support for Westeros compositor

	config BR2_PACKAGE_WESTEROS_XDG_SHELL_PROTOCOL_V5
		bool "xdg-shell v5"
		select BR2_PACKAGE_WESTEROS_HAS_XDG_SHELL 
		help
			Enable xdg-shell v5 protocol support for Westeros compositor
	
	config BR2_PACKAGE_WESTEROS_XDG_SHELL_PROTOCOL_V4
		bool "xdg-shell v4"
		select BR2_PACKAGE_WESTEROS_HAS_XDG_SHELL 
		help
			Enable xdg-shell v4 protocol support for Westeros compositor

	config BR2_PACKAGE_WESTEROS_XDG_SHELL_PROTOCOL_STABLE
		bool "xdg-shell stable"
		select BR2_PACKAGE_WESTEROS_HAS_XDG_SHELL 
		help
			Enable xdg-shell stable protocol support for Westeros compositor
	endchoice

	config BR2_PACKAGE_WESTEROS_SIMPLE_PROTOCOL
		bool "simple protocol (wl_sb, wl_simple_shell)"
		default y
		select BR2_PACKAGE_WESTEROS_SIPLEBUFFER
		select BR2_PACKAGE_WESTEROS_SIMPLESHELL
		help
			Enable simple buffer protocol and simple shell support for Westeros compositor
	 

	config BR2_PACKAGE_WESTEROS_DMA_BUF_PROTOCOL
		bool "dma-buf protocol (zwp_linux_dmabuf_v1)"
		help
			Enable dma-buf protocol support for Westeros compositor

	config BR2_PACKAGE_WESTEROS_EXPSYNC_PROTOCOL
		bool "expsync protocol (linux_explicit_synchronization_unstable_v1)"
		help
			Enable explicit synchonization protocol support for Westeros compositor

	config BR2_PACKAGE_WESTEROS_EMBEDDED_COMPOSITOR
		bool "embedded compositor"
		default y
		help
			Enable embedded compositor support for Westeros compositor

	config BR2_PACKAGE_WESTEROS_MODULES
		bool "modules"
		help
			Enable modules support for Westeros compositor

	config BR2_PACKAGE_WESTEROS_APPS
		bool "applications"
		help
			Included applications to run and test Westeros compositor 
			- westeros
			- westeros-player
			- westeros-test

	source "$BR2_EXTERNAL_ML_OSS_PATH/package/westeros/westeros-simpleshell/Config.in"	
	source "$BR2_EXTERNAL_ML_OSS_PATH/package/westeros/westeros-simplebuffer/Config.in"
	source "$BR2_EXTERNAL_ML_OSS_PATH/package/westeros/westeros-soc/Config.in"
	source "$BR2_EXTERNAL_ML_OSS_PATH/package/westeros/westeros-sink/Config.in"
endif #BR2_PACKAGE_WESTEROS
```
