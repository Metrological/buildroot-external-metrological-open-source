## package/thunder-opensource/thunder/Config.in
```kconfig
config BR2_PACKAGE_THUNDER
    select BR2_PACKAGE_CA_CERTIFICATES
    select BR2_PACKAGE_ZLIB
    bool "thunder"
    help
      Thunder Framework

if BR2_PACKAGE_THUNDER

menu "Options"

choice BR2_PACKAGE_THUNDER_BUILD_TYPE
    prompt "Build type"
    default BR2_PACKAGE_THUNDER_BUILD_TYPE_RELEASE
    help
      Select the type of build you want to use.

config BR2_PACKAGE_THUNDER_BUILD_TYPE_DEBUG
    bool "Debug"
    help
     This build type is with: traces, callstacks, symbols, asserts; without: optimizations.

config BR2_PACKAGE_THUNDER_BUILD_TYPE_DEBUG_OPTIMIZED
    bool "Debug optimized"
    help
     This build type is with: traces, callstacks, symbols, asserts.

config BR2_PACKAGE_THUNDER_BUILD_TYPE_RELEASE_WITH_SYMBOLS
    bool "Release with symbols"
    help
      This build type is with: callstacks, symbols; without: asserts, traces.

config BR2_PACKAGE_THUNDER_BUILD_TYPE_RELEASE
    bool "Release"
    help
      This build type is with: callstacks; without: asserts, traces, symbols.

config BR2_PACKAGE_THUNDER_BUILD_TYPE_PRODUCTION
    bool "Production"
    help
      This build type is without: traces, callstacks, symbols, asserts.

endchoice

choice BR2_PACKAGE_THUNDER_TRACE_LEVEL
    prompt "Tracing"
    default BR2_PACKAGE_THUNDER_TRACE_LEVEL_DEFAULT
    help
        Select which trace level (TRACE_LX) thunder reports.

    config BR2_PACKAGE_THUNDER_TRACE_LEVEL_DEFAULT
        bool "Default"
    config BR2_PACKAGE_THUNDER_TRACE_LEVEL_OFF
        bool "Off"
    config BR2_PACKAGE_THUNDER_TRACE_LEVEL_1
        bool "Level 1"
    config BR2_PACKAGE_THUNDER_TRACE_LEVEL_2
        bool "Level 2"
    config BR2_PACKAGE_THUNDER_TRACE_LEVEL_3
        bool "Level 3"
    config BR2_PACKAGE_THUNDER_TRACE_LEVEL_4
        bool "Level 4"
    config BR2_PACKAGE_THUNDER_TRACE_LEVEL_5
        bool "Level 5"
endchoice

config BR2_PACKAGE_THUNDER_CREATE_IPKG_TARGETS
    bool "create ipkg targets"
    select BR2_PACKAGE_HOST_OPKG_UTILS
    depends on BR2_PACKAGE_THUNDER_PACKAGER
    help
        Creates from configured targets, a DEBIAN 2.0 (ipk, opk, deb) packages. Configured packages will install theirs
        staging file, but not target files on the root filesystem

config BR2_PACKAGE_THUNDER_PORT
    string "port"
    default "80"

config BR2_PACKAGE_THUNDER_BIND
    string "bind"
    default "0.0.0.0"

config BR2_PACKAGE_THUNDER_INTERFACE
    string "interface"
    default ""

config BR2_PACKAGE_THUNDER_ETHERNETCARD_NAME
    string "ethernet card name"
    default "eth0"

config BR2_PACKAGE_THUNDER_IDLE_TIME
    string "idle-time"
    default "180"

config BR2_PACKAGE_THUNDER_SOFT_KILL_CHECK_WAIT
    string "soft-kill-chek-waittime"
    default "10"

config BR2_PACKAGE_THUNDER_HARD_KILL_CHECK_WAIT
    string "hard-kill-chek-waittime"
    default "4"

config BR2_PACKAGE_THUNDER_PERSISTENT_PATH
    string "persistent path"
    default "/root"

config BR2_PACKAGE_THUNDER_VOLATILE_PATH
    string "volatile path"
    default "/tmp"

config BR2_PACKAGE_THUNDER_DATA_PATH
    string "data path"
    default "/usr/share/Thunder"

config BR2_PACKAGE_THUNDER_INSTALL_PATH
    string "install path"
    default "/usr/share/Thunder"

config BR2_PACKAGE_THUNDER_SYSTEM_PATH
    string "system path"
    default "/usr/lib/thunder/plugins"

config BR2_PACKAGE_THUNDER_PROXYSTUB_PATH
    string "proxystub path"
    default "/usr/lib/thunder/proxystubs"

config BR2_PACKAGE_THUNDER_MESSAGING
    bool "messaging"
    help
      Enable the tracing and logging facility 
      within the framework.

config BR2_PACKAGE_THUNDER_OOM_ADJUST
    string "oom-adjust"
    default ""

config BR2_PACKAGE_THUNDER_UMASK
    string "umask"
    default ""
    help
      Set the umask for new files created by Thunder
      e.g. 0022 will not set the write permission for group and others

config BR2_PACKAGE_THUNDER_GROUP
    string "group"
    default "thunder"
    help
      Set a system group that need to the used by Thunder

config BR2_PACKAGE_THUNDER_SYSTEM_PREFIX
    string "system prefix"
    default ""

config BR2_PACKAGE_THUNDER_TRACING_MODULES
    string "tracing modules"
    default ""
    help
      A space separated list of specific tracing modules to be enabled at start.
      If empty all modules will be enabled.

config BR2_PACKAGE_THUNDER_DISABLE_LEGACY_CONFIG_GENERATOR
    bool "disable legacy config generator"
    default n
    help
      This disables the legacy config generator for all thunder components by default
      even if you build with a cmake version < v3.20.0.

config BR2_PACKAGE_THUNDER_HIDE_NON_EXTERNAL_SYMBOLS
    bool "hide non external symbols"
    default y
    help
        This will hide all symbols that are not marked as EXTERNAL, making
        the binaries flash footprint smaller.

config BR2_PACKAGE_THUNDER_ENABLE_STRICT_COMPILER
    bool "strict compiler settings"
    default y
    help
        Enabling this will trigger more warnings and turn them into compile errors.


config BR2_PACKAGE_THUNDER_EXCEPTIONS_ENABLE
    bool "exceptions"
    default n
    help
        Enable the use of exceptions.

config BR2_PACKAGE_THUNDER_PERFORMANCE_MONITORING
    bool "performance monitoring"
    default n
    help
        Enable the performance monitoring.

config BR2_PACKAGE_THUNDER_ENABLE_ENVIRONMENT
    bool "environment fragments support"
    default n
    help
        Enable the use of environment fragments. This will add a new
        environment variable to the process that will contain the
        environment variables that are set in the fragments.
        This is used to set up the environment for the plugins.

menu "Platform Device Groups"

comment "This should match the groups applied to the respective platforms device recourses."

config BR2_PACKAGE_THUNDER_PLATFORM_VIDEO_DEVICE_GROUP
    string "video"
    default video
    help
        This should be set to the group needed to access the video devices on the platform.


# config BR2_PACKAGE_THUNDER_PLATFORM_AUDIO_DEVICE_GROUP
#     string "audio"
#     default audio
#     help
#         This should be set to the group needed to access the audio devices on the platform.


# config BR2_PACKAGE_THUNDER_PLATFORM_INPUT_DEVICE_GROUP
#     string "input"
#     default input
#     help
#         This should be set to the group needed to access the inpout devices on the platform.
         
endmenu
source "$BR2_EXTERNAL_ML_OSS_PATH/package/thunder-opensource/thunder-devtools/Config.in"

endmenu

menu "Extensions"

menuconfig BR2_PACKAGE_THUNDER_BROADCAST
    bool "Broadcast"
        default n
    help
      Abstraction on QAM tuner and PSI/SI parser functionality.

if BR2_PACKAGE_THUNDER_BROADCAST
config BR2_PACKAGE_THUNDER_BROADCAST_SI_PARSING
    bool "SI Parsing"
        default n
    help
      Enable functionality to automatically parse SI information on the
          tuned streams.
endif

config BR2_PACKAGE_THUNDER_EXTENSION_PRIVILEDGED_REQUEST
    bool "Priviledged Request"
    help
      Library to share file desciptors between processes.

config BR2_PACKAGE_THUNDER_GRAPHICS_BUFFER
    select BR2_PACKAGE_THUNDER_CLIENTLIBRARIES
    select BR2_PACKAGE_THUNDER_EXTENSION_PRIVILEDGED_REQUEST
    bool "Graphics Buffer"
    help
      Library to share graphical buffers between processes.

config BR2_PACKAGE_THUNDER_CLIENTLIBRARY_CDM
    select BR2_PACKAGE_THUNDER_CLIENTLIBRARIES
    bool "CDM"
    help
      CDM client support compatible with OpenCDM

menuconfig BR2_PACKAGE_THUNDER_BLUETOOTH
    bool "Bluetooth"
    help
      Thunder Bluetooth User Space Stack

if BR2_PACKAGE_THUNDER_BLUETOOTH

choice
    prompt "BlueZ header source"
    default BR2_PACKAGE_THUNDER_BLUETOOTH_USE_SYSTEM_BLUEZ_HEADERS

config BR2_PACKAGE_THUNDER_BLUETOOTH_USE_SYSTEM_BLUEZ_HEADERS
    bool "Use system BlueZ headers"
    select BR2_PACKAGE_BLUEZ5_UTILS_HEADERS

config BR2_PACKAGE_THUNDER_BLUETOOTH_DOWNLOAD_BLUEZ_HEADERS
    bool "Download private BlueZ headers"

endchoice

endif

menuconfig BR2_PACKAGE_THUNDER_CLIENTLIBRARY_COMPOSITORCLIENT
	select BR2_PACKAGE_THUNDER_CLIENTLIBRARIES
	bool "CompositorClient"
	default y
	help
	  A graphical/input abstraction. This library is included in micro services that requires user
	  interaction (Graphics/input). The implementation hides all the compositor specific details.
	  allows for relaying keys to plugins
if BR2_PACKAGE_THUNDER_CLIENTLIBRARY_COMPOSITORCLIENT

config BR2_PACKAGE_THUNDER_CLIENTLIBRARY_COMPOSITORCLIENT_BUILD_TESTS
	bool "CompositorClient Tests"
	default y
	help
	  Build CompositorClient test applications including the texture
	  renderer test app and associated test plugins for validating
	  compositor client functionality.

config BR2_PACKAGE_THUNDER_CLIENTLIBRARY_COMPOSITORCLIENT_TESTS_INSTALL_GBM_UTIL
	bool "CompositorClient GBM Surface"
	depends on BR2_PACKAGE_THUNDER_CLIENTLIBRARY_COMPOSITORCLIENT_BUILD_TESTS
	help
	  Install the GBM surface util to discover proper GBM behaviour.

config BR2_PACKAGE_THUNDER_CLIENTLIBRARY_COMPOSITORCLIENT_TESTS_INSTALL_RENDER_APP
	bool "CompositorClient Render App"
	depends on BR2_PACKAGE_THUNDER_CLIENTLIBRARY_COMPOSITORCLIENT_BUILD_TESTS
	help
	  Install the texture renderer test application for validating
	  compositor client rendering functionality.

config BR2_PACKAGE_THUNDER_CLIENTLIBRARY_COMPOSITORCLIENT_TESTS_INSTALL_RENDER_PLUGIN
	bool "CompositorClient Render Plugin"
	depends on BR2_PACKAGE_THUNDER_CLIENTLIBRARY_COMPOSITORCLIENT_BUILD_TESTS
	help
	  Install the texture renderer test plugin for validating
	  compositor client plugin functionality.

if BR2_PACKAGE_THUNDER_CLIENTLIBRARY_COMPOSITORCLIENT_TESTS_INSTALL_RENDER_PLUGIN

choice
	prompt "Plugin Start Mode"
	default BR2_PACKAGE_THUNDER_CLIENTLIBRARY_COMPOSITORCLIENT_PLUGIN_STARTMODE_ACTIVATED
	help
	  Controls when the ClientCompositorRender plugin starts.

config BR2_PACKAGE_THUNDER_CLIENTLIBRARY_COMPOSITORCLIENT_PLUGIN_STARTMODE_ACTIVATED
	bool "Activated"

config BR2_PACKAGE_THUNDER_CLIENTLIBRARY_COMPOSITORCLIENT_PLUGIN_STARTMODE_DEACTIVATED
	bool "Deactivated"

endchoice

config BR2_PACKAGE_THUNDER_CLIENTLIBRARY_COMPOSITORCLIENT_PLUGIN_STARTMODE
	string
	default "Activated" if BR2_PACKAGE_THUNDER_CLIENTLIBRARY_COMPOSITORCLIENT_PLUGIN_STARTMODE_ACTIVATED
	default "Deactivated" if BR2_PACKAGE_THUNDER_CLIENTLIBRARY_COMPOSITORCLIENT_PLUGIN_STARTMODE_DEACTIVATED

config BR2_PACKAGE_THUNDER_CLIENTLIBRARY_COMPOSITORCLIENT_PLUGIN_RESUMED
	bool "Plugin Resumed State"
	default y
	help
	  Set ClientCompositorRender plugin resume state.

choice
	prompt "Plugin Mode"
	default BR2_PACKAGE_THUNDER_CLIENTLIBRARY_COMPOSITORCLIENT_PLUGIN_MODE_LOCAL
	help
	  Controls if the plugin runs in its own process, in-process, or remote.

config BR2_PACKAGE_THUNDER_CLIENTLIBRARY_COMPOSITORCLIENT_PLUGIN_MODE_LOCAL
	bool "Local"

config BR2_PACKAGE_THUNDER_CLIENTLIBRARY_COMPOSITORCLIENT_PLUGIN_MODE_OFF
	bool "Off"

config BR2_PACKAGE_THUNDER_CLIENTLIBRARY_COMPOSITORCLIENT_PLUGIN_MODE_CONTAINER
	bool "Container"

config BR2_PACKAGE_THUNDER_CLIENTLIBRARY_COMPOSITORCLIENT_PLUGIN_MODE_DISTRIBUTED
	bool "Distributed

endchoice

config BR2_PACKAGE_THUNDER_CLIENTLIBRARY_COMPOSITORCLIENT_PLUGIN_MODE
	string
	default "Local" if BR2_PACKAGE_THUNDER_CLIENTLIBRARY_COMPOSITORCLIENT_PLUGIN_MODE_LOCAL
	default "Off" if BR2_PACKAGE_THUNDER_CLIENTLIBRARY_COMPOSITORCLIENT_PLUGIN_MODE_OFF
	default "Container" if BR2_PACKAGE_THUNDER_CLIENTLIBRARY_COMPOSITORCLIENT_PLUGIN_MODE_CONTAINER
	default "Distributed" if BR2_PACKAGE_THUNDER_CLIENTLIBRARY_COMPOSITORCLIENT_PLUGIN_MODE_DISTRIBUTED

config BR2_PACKAGE_THUNDER_CLIENTLIBRARY_COMPOSITORCLIENT_PLUGIN_INSTANCES
	int "Number of Plugin Instances"
	default 1
	range 1 10
	help
	  Controls how many instances of the plugin will be installed.

endif

endif

config BR2_PACKAGE_THUNDER_BLUETOOTH_GATT
    select BR2_PACKAGE_THUNDER_BLUETOOTH
    bool

config BR2_PACKAGE_THUNDER_BLUETOOTH_AUDIO
    select BR2_PACKAGE_THUNDER_BLUETOOTH
    select BR2_PACKAGE_SBC
    bool

config BR2_PACKAGE_THUNDER_EXTENSION_LOCALTRACER
    bool "Local Tracer"
        default n
    help
      Use tracing without the need of Thunder running. 
      
if BR2_PACKAGE_THUNDER_BLUETOOTH
menuconfig BR2_PACKAGE_THUNDER_CLIENTLIBRARY_BLUETOOTHAUDIOSINK
    select BR2_PACKAGE_THUNDER_CLIENTLIBRARIES
    depends on BR2_PACKAGE_THUNDER_BLUETOOTHAUDIO_SINK
    bool "BluetoothAudioSink"
        default n
    help
      C-interface towards BluetoothAudio plugin for controlling the Bluetooth sink and supplying audio data samples

if BR2_PACKAGE_THUNDER_CLIENTLIBRARY_BLUETOOTHAUDIOSINK

if BR2_PACKAGE_GSTREAMER1
config BR2_PACKAGE_THUNDER_CLIENTLIBRARY_BLUETOOTHAUDIOSINK_GSTREAMERELEMENT
    select BR2_PACKAGE_GST1_BLUETOOTHAUDIOSINK
    bool "GStreamer audio sink element"
    default n
endif

config BR2_PACKAGE_THUNDER_CLIENTLIBRARY_BLUETOOTHAUDIOSINK_EXAMPLEPLAYER
    bool "Example .wav player"
    default y
endif

menuconfig BR2_PACKAGE_THUNDER_CLIENTLIBRARY_BLUETOOTHAUDIOSOURCE
    select BR2_PACKAGE_THUNDER_CLIENTLIBRARIES
    depends on BR2_PACKAGE_THUNDER_BLUETOOTHAUDIO_SOURCE
    bool "BluetoothAudioSource"
        default n
    help
      C-interface towards BluetoothAudio plugin for controlling the Bluetooth source and receiving audio data samples

if BR2_PACKAGE_THUNDER_CLIENTLIBRARY_BLUETOOTHAUDIOSOURCE

if BR2_PACKAGE_GSTREAMER1
config BR2_PACKAGE_THUNDER_CLIENTLIBRARY_BLUETOOTHAUDIOSOURCE_GSTREAMERELEMENT
    select BR2_PACKAGE_GST1_BLUETOOTHAUDIOSOURCE
    bool "GStreamer audio source element"
    default n
endif

config BR2_PACKAGE_THUNDER_CLIENTLIBRARY_BLUETOOTHAUDIOSOURCE_EXAMPLERECORDER
    bool "Example .wav recorder"
    default y
endif
endif

config BR2_PACKAGE_THUNDER_CLIENTLIBRARY_DEVICEINFO
    select BR2_PACKAGE_THUNDER_CLIENTLIBRARIES
    bool "DeviceInfo"
        default y if BR2_PACKAGE_THUNDER_DEVICEINFO
    help
        A helpful C-interface to easily get information from the DeviceInfo plugin.

config BR2_PACKAGE_THUNDER_CLIENTLIBRARY_DISPLAYINFO
    select BR2_PACKAGE_THUNDER_CLIENTLIBRARIES
    bool "DisplayInfo"
        default y if BR2_PACKAGE_THUNDER_DISPLAYINFO
    help
        A helpful C-interface to easily get information from the DisplayInfo plugin.

config BR2_PACKAGE_THUNDER_CLIENTLIBRARY_PLAYERINFO
    select BR2_PACKAGE_THUNDER_CLIENTLIBRARIES
    bool "PlayerInfo"
    default y if BR2_PACKAGE_THUNDER_PLAYERINFO
    help
        A helpful C-interface to easily get information from the PlayerInfo plugin.

menuconfig BR2_PACKAGE_THUNDER_CLIENTLIBRARY_CRYPTOGRAPHY
    select BR2_PACKAGE_THUNDER_CLIENTLIBRARIES
    bool "Cryptography"
        default n
    help
      Abstraction on generic cryptography functionality.

if BR2_PACKAGE_THUNDER_CLIENTLIBRARY_CRYPTOGRAPHY
choice BR2_PACKAGE_THUNDER_CLIENTLIBRARY_CRYPTOGRAPHY_IMPLEMENTATION
	prompt "Implementation"
	default BR2_PACKAGE_THUNDER_CLIENTLIBRARY_CRYPTOGRAPHY_IMPLEMENTATION_OPENSSL
	help
	  Choose implementation

config BR2_PACKAGE_THUNDER_CLIENTLIBRARY_CRYPTOGRAPHY_IMPLEMENTATION_THUNDER
	bool "Thunder"
	help
	  Use Thunder as cryptography backend.

config BR2_PACKAGE_THUNDER_CLIENTLIBRARY_CRYPTOGRAPHY_IMPLEMENTATION_OPENSSL
	bool "OpenSSL"
	depends on BR2_PACKAGE_OPENSSL
	help
	  Use OpenSSL as cryptography backend.

config BR2_PACKAGE_THUNDER_CLIENTLIBRARY_CRYPTOGRAPHY_IMPLEMENTATION_NEXUS
	bool "Nexus"
	depends on BR2_PACKAGE_HAS_NEXUS
	help
	  Use Nexus as cryptography backend.
endchoice

if BR2_PACKAGE_THUNDER_CLIENTLIBRARY_CRYPTOGRAPHY_IMPLEMENTATION_NEXUS
menu "Nexus Implemention Options"
choice BR2_PACKAGE_THUNDER_CLIENTLIBRARY_CRYPTOGRAPHY_NEXUS_IMPLEMENTATION
	prompt "Implementation"
	default BR2_PACKAGE_THUNDER_CLIENTLIBRARY_CRYPTOGRAPHY_IMPLEMENTATION_NEXUS_DRM_BASED
	help
	  Choose Nexus implementation type

config BR2_PACKAGE_THUNDER_CLIENTLIBRARY_CRYPTOGRAPHY_IMPLEMENTATION_NEXUS_DRM_BASED
	bool "DRM based"
	help
	  Use DRM based implementation.

config BR2_PACKAGE_THUNDER_CLIENTLIBRARY_CRYPTOGRAPHY_IMPLEMENTATION_NEXUS_COMMAND_BASED
	bool "TEE Command based"
	help
	  Use TEE Command based implementation
endchoice
endmenu
endif
endif

config BR2_PACKAGE_THUNDER_WARNING_REPORTING
    bool "DefensiveWarnings"
    default n
    help
      Add a defensive warning system to the Thunder. It increases the footprint
      of the Thunder application but it allows for profiling and early warning
      on misbahving plugins. This feature should be used at least once before
      creating a production build to get a feeling on the behaviour of new
      plugins. They should not raise any warnings here !!!

config BR2_PACKAGE_THUNDER_EXCEPTION_CATCHING
    bool "ExceptionCatching"
    default n
    help
      Some plugins are developed with Exception handling turned on. If an exception
      is not caught in the plugin it ends up in the framework. This feature tries 
      to recover from these uncaught execptions. If it happens on a workerpool thread
      the framework will catch it, report it and continue. If the exception is thrown
      from a thread not under control of the framework it reports and shutsdown the
      framework. There is no possibility to recover from it.

config BR2_PACKAGE_THUNDER_PROVISIONPROXY
    select BR2_PACKAGE_THUNDER_CLIENTLIBRARIES
    bool "ProvisionProxy"
    select BR2_PACKAGE_LIBPROVISION
    help
      Allows provisioning of modules from the cloud.

menuconfig BR2_PACKAGE_THUNDER_PROCESSCONTAINERS
    bool "Process Containers"
        default n
    help
      Enable ability to start a containerized nanoservices

if BR2_PACKAGE_THUNDER_PROCESSCONTAINERS

config BR2_PACKAGE_THUNDER_PROCESSCONTAINERS_BE_LXC
    bool "LXC"
    select BR2_PACKAGE_LXC
    select BR2_PACKAGE_CGROUPFS_MOUNT

config BR2_PACKAGE_THUNDER_PROCESSCONTAINERS_BE_RUNC
    bool "runC"
    select BR2_PACKAGE_RUNC
    select BR2_PACKAGE_CGROUPFS_MOUNT

config BR2_PACKAGE_THUNDER_PROCESSCONTAINERS_BE_CRUN
    bool "crun"
    select BR2_PACKAGE_CRUN
    select BR2_PACKAGE_CGROUPFS_MOUNT

endif

config BR2_PACKAGE_THUNDER_SECURE_SOCKET
    bool "SecureSocket"
    select BR2_PACKAGE_OPENSSL
    help
      Adds a Secure Socket implementation (dependency OpenSSL)


config BR2_PACKAGE_THUNDER_SECURITYAGENT_ACCESSOR
    select BR2_PACKAGE_THUNDER_CLIENTLIBRARIES
    bool "SecurityAgent"
    help
      Allows external access to the Security Agent, through a C interface.

config BR2_PACKAGE_THUNDER_VIRTUALINPUT
    select BR2_PACKAGE_THUNDER_CLIENTLIBRARIES
    bool "VirtualInput"
    help
      If the dynamic uinput system can not be used for security reasons, this
      allows for relaying keys to plugins

config BR2_PACKAGE_THUNDER_INSTALL_INITD_DEPRECATED
    bool "Init.d script from package config (deprecated)"
    help
      Install thunder config file from buildroot package config folder"
endmenu

endif
```
