## package/ssl-key/Config.in
```kconfig
config BR2_PACKAGE_SSL_KEY
	bool "ssl key"
        depends on BR2_PACKAGE_DROPBEAR
	help
	  Prepare target with a SSL key for passwordless ssh connections.

comment "ssl key needs dropbear"
	depends on !BR2_PACKAGE_DROPBEAR

choice
	prompt "SSL key source"
	default BR2_PACKAGE_SSL_KEY_GENERATE
	depends on BR2_PACKAGE_SSL_KEY

config BR2_PACKAGE_SSL_KEY_CUSTOM
	bool "Custom public key"

config BR2_PACKAGE_SSL_KEY_GENERATE
	bool "Generate key pair"
endchoice

config BR2_PACKAGE_SSL_KEY_CUSTOM_PUBLIC_KEY
	string "Location of custom private key"
	depends on BR2_PACKAGE_SSL_KEY_CUSTOM
	help
	  Enter the path to the custom pulic key you want to copy.
```

## package/thunder-opensource/Config.in
```kconfig
source "$BR2_EXTERNAL_ML_OSS_PATH/package/thunder-opensource/thunder/Config.in"

menu "Thunder Plugins"
source "$BR2_EXTERNAL_ML_OSS_PATH/package/thunder-opensource/thunder-plugins/Config.in"
source "$BR2_EXTERNAL_ML_OSS_PATH/package/thunder-opensource/thunder-launcher/Config.in"
source "$BR2_EXTERNAL_ML_OSS_PATH/package/thunder-opensource/thunder-doofah/Config.in"
source "$BR2_EXTERNAL_ML_OSS_PATH/package/thunder-opensource/thunder-screensaver/Config.in"
source "$BR2_EXTERNAL_ML_OSS_PATH/package/thunder-opensource/thunder-packagemanager/Config.in"
endmenu

source "$BR2_EXTERNAL_ML_OSS_PATH/package/thunder-opensource/thunder-ui/Config.in"

source "$BR2_EXTERNAL_ML_OSS_PATH/package/thunder-opensource/thunder-interfaces/Config.in"
source "$BR2_EXTERNAL_ML_OSS_PATH/package/thunder-opensource/thunder-clientlibraries/Config.in"
source "$BR2_EXTERNAL_ML_OSS_PATH/package/thunder-opensource/thunder-libraries/Config.in"
source "$BR2_EXTERNAL_ML_OSS_PATH/package/thunder-opensource/thunder-rdkservices/Config.in"
```

## package/thunder-opensource/thunder-doofah/Config.in
```kconfig
comment "Thunder Doofah plugin needs thunder"
	depends on !BR2_PACKAGE_THUNDER

menuconfig BR2_PACKAGE_THUNDER_DOOFAH
    bool "Doofah"
    depends on BR2_PACKAGE_THUNDER
    help
    	Plugin to act as a remote control on your test
    	workbench

if BR2_PACKAGE_THUNDER_DOOFAH 
config BR2_PACKAGE_THUNDER_DOOFAH_AUTOSTART
    bool "Start Automatically"
    default y
    help
      Select this to start the plugin automatically when starting Thunder

config BR2_PACKAGE_THUNDER_DOOFAH_CONNECTOR_CONFIG
    string "Connector config"
    help
      Set a custom connector configutarion 

endif
```

## package/thunder-opensource/thunder-interfaces/Config.in
```kconfig
config BR2_PACKAGE_THUNDER_INTERFACES
    bool
    depends on BR2_PACKAGE_THUNDER
    default y if BR2_PACKAGE_THUNDER
```

## package/thunder-opensource/thunder-launcher/Config.in
```kconfig
config BR2_PACKAGE_THUNDER_LAUNCHER
	bool "Launcher"
        default n
	help
	   WPE Platform Launcher plugin
           This plugin can be used as a *temporary* solution
           to launch linux applications and linux scripts.
```

## package/thunder-opensource/thunder-libraries/Config.in
```kconfig
config BR2_PACKAGE_THUNDER_LIBRARIES
    bool "thunderlibraries"
    default n

    help
       Thunder Libraries
```

## package/thunder-opensource/thunder-packagemanager/Config.in
```kconfig
comment "Thunder PackageManager plugin needs thunder"
	depends on !BR2_PACKAGE_THUNDER

menuconfig BR2_PACKAGE_THUNDER_PACKAGEMANAGER
    bool "PackageManager"
    depends on BR2_PACKAGE_THUNDER
    help
    	The PackageManager plugin allows installation of packages on the system from a remote repository in a Firebolt system
    	
if BR2_PACKAGE_THUNDER_PACKAGEMANAGER 
config BR2_PACKAGE_THUNDER_PACKAGEMANAGER_AUTOSTART
    bool "Start Automatically"
    default y
    help
      Select this to start the plugin automatically when starting Thunder

endif
```

## package/thunder-opensource/thunder-rdkservices/Config.in
```kconfig
config BR2_PACKAGE_THUNDER_RDKSERVICES
    bool
    select BR2_PACKAGE_THUNDER_CLIENTLIBRARIES
```

## package/thunder-opensource/thunder-screensaver/Config.in
```kconfig
comment "Thunder ScreenSaver plugin needs compositorclient"
	depends on !BR2_PACKAGE_THUNDER_CLIENTLIBRARY_COMPOSITORCLIENT

menuconfig BR2_PACKAGE_THUNDER_SCREENSAVER
    bool "Screensaver"
    depends on BR2_PACKAGE_THUNDER_CLIENTLIBRARY_COMPOSITORCLIENT
    help
    	Plugin to test EGL using compositorclients

if BR2_PACKAGE_THUNDER_SCREENSAVER
config BR2_PACKAGE_THUNDER_SCREENSAVER_AUTOSTART
    bool "Start Automatically"
    default y
    help
      Select this to start the plugin automatically when starting Thunder

endif
```

## package/thunder-opensource/thunder-tools/Config.in
```kconfig
config BR2_PACKAGE_THUNDER_TOOLS
	bool "thunder-tools"
	help
	  WPE Framework Tooling
```

## package/thunder-opensource/thunder-ui/Config.in
```kconfig
config BR2_PACKAGE_THUNDER_UI
    bool "Thunder WebUI"
    depends on BR2_PACKAGE_THUNDER
    default y if BR2_PACKAGE_THUNDER
    help
        WPE Framework User Interface for development and testing

comment "Thunder WebUI needs thunder"
	depends on !BR2_PACKAGE_THUNDER
```
