## package/westeros/westeros-simpleshell/Config.in
```kconfig
config BR2_PACKAGE_WESTEROS_SIMPLESHELL
	bool "westeros-simpleshell"
	depends on BR2_PACKAGE_WESTEROS_SIMPLE_PROTOCOL
	select BR2_PACKAGE_WAYLAND
	select BR2_PACKAGE_WAYLAND_PROTOCOLS
	select BR2_PACKAGE_LIBXKBCOMMON
	select BR2_PACKAGE_LIBGLIB2
	help
		wayland shell based on shared memory buffers.
        
		https://code.rdkcentral.com/r/components/opensource/westeros

comment "westeros-simpleshell needs simple buffer protocol"
		depends on !BR2_PACKAGE_WESTEROS_SIMPLE_PROTOCOL
```

## package/westeros/westeros-sink/Config.in
```kconfig
config BR2_PACKAGE_WESTEROS_SINK
	bool "westeros-sink"
	select BR2_PACKAGE_GSTREAMER1
	select BR2_PACKAGE_WAYLAND
	select BR2_PACKAGE_WAYLAND_PROTOCOLS
	select BR2_PACKAGE_WAYLAND_EGL_BNXS if BR2_PACKAGE_HAS_NEXUS

	help
	  GStreamer sink for westeros.

	  https://github.com/rdkcmf/westeros
```

## package/westeros/westeros-soc/Config.in
```kconfig
config BR2_PACKAGE_WESTEROS_SOC
	bool "westeros-soc"
	select BR2_PACKAGE_WAYLAND
	select BR2_PACKAGE_WAYLAND_PROTOCOLS
	select BR2_PACKAGE_WAYLAND_EGL_BNXS if BR2_PACKAGE_HAS_NEXUS
	help
		SOC hardware abstraction for westeros 

		https://code.rdkcentral.com/r/components/opensource/westeros
```

## package/wpeframework-opensource/Config.in
```kconfig
source "$BR2_EXTERNAL_ML_OSS_PATH/package/wpeframework-opensource/wpeframework/Config.in"

menu "WPEFramework Plugins"
source "$BR2_EXTERNAL_ML_OSS_PATH/package/wpeframework-opensource/wpeframework-plugins/Config.in"
source "$BR2_EXTERNAL_ML_OSS_PATH/package/wpeframework-opensource/wpeframework-launcher/Config.in"
source "$BR2_EXTERNAL_ML_OSS_PATH/package/wpeframework-opensource/wpeframework-doofah/Config.in"
source "$BR2_EXTERNAL_ML_OSS_PATH/package/wpeframework-opensource/wpeframework-screensaver/Config.in"
endmenu

source "$BR2_EXTERNAL_ML_OSS_PATH/package/wpeframework-opensource/wpeframework-ui/Config.in"

source "$BR2_EXTERNAL_ML_OSS_PATH/package/wpeframework-opensource/wpeframework-interfaces/Config.in"
source "$BR2_EXTERNAL_ML_OSS_PATH/package/wpeframework-opensource/wpeframework-clientlibraries/Config.in"
source "$BR2_EXTERNAL_ML_OSS_PATH/package/wpeframework-opensource/wpeframework-libraries/Config.in"
source "$BR2_EXTERNAL_ML_OSS_PATH/package/wpeframework-opensource/wpeframework-rdkservices/Config.in"
```

## package/wpeframework-opensource/wpeframework-cdmi/Config.in
```kconfig
if BR2_PACKAGE_HAS_NEXUS_SAGE
config	BR2_PACKAGE_WPEFRAMEWORK_CDMI_SOFTWARE_OVERRIDE
	bool "software decryption"
        depends on BR2_PACKAGE_HAS_NEXUS_SAGE || BR2_PACKAGE_VSS_SDK
	default y if BR2_PACKAGE_HAS_NEXUS_SAGE || BR2_PACKAGE_VSS_SDK
	help
	  By default, if a secure path is available on the platform, the DRM module capable of 
          decrypting in the TEE is selected. Selecting this option will always, if available,
          select a software decryption DRM module, over the TEE version. 
          NOTE: Software and TEE DRM module can *NOT* be used together.
endif

if !BR2_PACKAGE_HAS_NEXUS_SAGE && !BR2_PACKAGE_VSS_SDK
config	BR2_PACKAGE_WPEFRAMEWORK_CDMI_SOFTWARE_OVERRIDE
	default y if BR2_PACKAGE_WPEFRAMEWORK 
	bool
endif

source "$BR2_EXTERNAL_ML_OSS_PATH/package/wpeframework-opensource/wpeframework-cdmi/ClearkeyConfig.in"
source "$BR2_EXTERNAL_ML_OSS_PATH/package/wpeframework-opensource/wpeframework-cdmi/PlayreadyConfig.in"
source "$BR2_EXTERNAL_ML_OSS_PATH/package/wpeframework-opensource/wpeframework-cdmi/WidevineConfig.in"
source "$BR2_EXTERNAL_ML_OSS_PATH/package/wpeframework-opensource/wpeframework-cdmi/NagraConfig.in"
source "$BR2_EXTERNAL_ML_OSS_PATH/package/wpeframework-opensource/wpeframework-cdmi/NCASConfig.in"
```

## package/wpeframework-opensource/wpeframework-clientlibraries/Config.in
```kconfig
config BR2_PACKAGE_WPEFRAMEWORK_CLIENTLIBRARIES
    select BR2_PACKAGE_WPEFRAMEWORK_LIBRARIES if BR2_PACKAGE_MESA3D && BR2_PACKAGE_WPEFRAMEWORK_CLIENTLIBRARY_COMPOSITORCLIENT
    bool
```

## package/wpeframework-opensource/wpeframework-doofah/Config.in
```kconfig
comment "WPEFramework Doofah plugin needs wpeframework"
	depends on !BR2_PACKAGE_WPEFRAMEWORK

menuconfig BR2_PACKAGE_WPEFRAMEWORK_DOOFAH
    bool "Doofah"
    depends on BR2_PACKAGE_WPEFRAMEWORK
    help
    	Plugin to act as a remote control on your test
    	workbench

if BR2_PACKAGE_WPEFRAMEWORK_DOOFAH 
config BR2_PACKAGE_WPEFRAMEWORK_DOOFAH_AUTOSTART
    bool "Start Automatically"
    default y
    help
      Select this to start the plugin automatically when starting WPEFramework

config BR2_PACKAGE_WPEFRAMEWORK_DOOFAH_ENDPOINT
    string "Specific end-point"
    help
      Set a specific device address to do 

config BR2_PACKAGE_WPEFRAMEWORK_DOOFAH_CONNECTOR_CONFIG
    string "Connector config"
    help
      Set a custom connector configutarion 

choice BR2_PACKAGE_WPEFRAMEWORK_DOOFAH_PERIPHERAL
    default BR2_PACKAGE_WPEFRAMEWORK_DOOFAH_PERIPHERAL_ROOT
    prompt "peripheral"
    help
      Select the peripheral you want to use as an endpoint

config BR2_PACKAGE_WPEFRAMEWORK_DOOFAH_PERIPHERAL_BLE
    bool "BLE"
    help
      Set the bluetooth low energy as the the endpoint

config BR2_PACKAGE_WPEFRAMEWORK_DOOFAH_PERIPHERAL_IR
    bool "IR"
    help
      Set the infrared as the the endpoint

config BR2_PACKAGE_WPEFRAMEWORK_DOOFAH_PERIPHERAL_ROOT
    bool "root"
    help
      Set the root device as the the endpoint

endchoice
endif
```

## package/wpeframework-opensource/wpeframework-interfaces/Config.in
```kconfig
config BR2_PACKAGE_WPEFRAMEWORK_INTERFACES
    bool
    depends on BR2_PACKAGE_WPEFRAMEWORK
    default y if BR2_PACKAGE_WPEFRAMEWORK
```

## package/wpeframework-opensource/wpeframework-libraries/Config.in
```kconfig
config BR2_PACKAGE_WPEFRAMEWORK_LIBRARIES
    select BR2_PACKAGE_BLUEZ5_UTILS_HEADERS if BR2_PACKAGE_WPEFRAMEWORK_BLUETOOTH
    bool
```

## package/wpeframework-opensource/wpeframework-rdkservices/Config.in
```kconfig
config BR2_PACKAGE_WPEFRAMEWORK_RDKSERVICES
    bool
    select BR2_PACKAGE_WPEFRAMEWORK_CLIENTLIBRARIES
```

## package/wpeframework-opensource/wpeframework-screensaver/Config.in
```kconfig
comment "WPEFramework ScreenSaver plugin needs compositorclient"
	depends on !BR2_PACKAGE_WPEFRAMEWORK_CLIENTLIBRARY_COMPOSITORCLIENT

menuconfig BR2_PACKAGE_WPEFRAMEWORK_SCREENSAVER
    bool "Screensaver"
    depends on BR2_PACKAGE_WPEFRAMEWORK_CLIENTLIBRARY_COMPOSITORCLIENT
    help
    	Plugin to test EGL using compositorclients

if BR2_PACKAGE_WPEFRAMEWORK_SCREENSAVER
config BR2_PACKAGE_WPEFRAMEWORK_SCREENSAVER_AUTOSTART
    bool "Start Automatically"
    default y
    help
      Select this to start the plugin automatically when starting WPEFramework

endif
```

## package/wpeframework-opensource/wpeframework-ui/Config.in
```kconfig
config BR2_PACKAGE_WPEFRAMEWORK_UI
	bool "WPEFramework WebUI"
    depends on BR2_PACKAGE_WPEFRAMEWORK
    default y if BR2_PACKAGE_WPEFRAMEWORK
	help
	   WPE Framework User Interface for development and testing

comment "WPEFramework WebUI needs wpeframework"
	depends on !BR2_PACKAGE_WPEFRAMEWORK
```
