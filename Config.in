## configs/raspberrypi4_64_wpe_defconfig
```kconfig
BR2_aarch64=y
BR2_cortex_a72=y
BR2_ARM_FPU_VFPV4=y
BR2_TOOLCHAIN_BUILDROOT_GLIBC=y
BR2_PACKAGE_HOST_LINUX_HEADERS_CUSTOM_5_15=y
BR2_TOOLCHAIN_BUILDROOT_CXX=y
BR2_PACKAGE_HOST_GDB=y
BR2_CCACHE=y
BR2_GLOBAL_PATCH_DIR="${BR2_EXTERNAL_ML_OSS_PATH}/patches"
BR2_ROOTFS_DEVICE_CREATION_DYNAMIC_EUDEV=y
BR2_TARGET_GENERIC_ROOT_PASSWD="root"
BR2_SYSTEM_DHCP="eth0"
BR2_ROOTFS_POST_BUILD_SCRIPT="${BR2_EXTERNAL_ML_OSS_PATH}/board/raspberrypi4-64/post-build.sh"
BR2_ROOTFS_POST_IMAGE_SCRIPT="${BR2_EXTERNAL_ML_OSS_PATH}/board/raspberrypi4-64/post-image.sh"
BR2_LINUX_KERNEL=y
BR2_LINUX_KERNEL_CUSTOM_TARBALL=y
BR2_LINUX_KERNEL_CUSTOM_TARBALL_LOCATION="$(call github,raspberrypi,linux,4ee9d0f86680c63bb99da598d8d7f4e62b004e96)/linux-4ee9d0f86680c63bb99da598d8d7f4e62b004e96.tar.gz"
BR2_LINUX_KERNEL_DEFCONFIG="bcm2711"
BR2_LINUX_KERNEL_CONFIG_FRAGMENT_FILES="${BR2_EXTERNAL_ML_OSS_PATH}/board/metrological/kernel-fragments/disable-module-compression.cnf"
BR2_LINUX_KERNEL_DTS_SUPPORT=y
BR2_LINUX_KERNEL_INTREE_DTS_NAME="broadcom/bcm2711-rpi-4-b"
BR2_LINUX_KERNEL_NEEDS_HOST_OPENSSL=y
BR2_PACKAGE_GST1_PLUGINS_BASE_LIB_OPENGL=y
BR2_PACKAGE_GST1_PLUGINS_GOOD_PLUGIN_V4L2=y
BR2_PACKAGE_GST1_PLUGINS_BAD=y
BR2_PACKAGE_GST1_PLUGINS_BAD_PLUGIN_KMS=y
BR2_PACKAGE_GST1_PLUGINS_BAD_PLUGIN_WEBP=y
BR2_PACKAGE_GST1_PLUGINS_UGLY=y
BR2_PACKAGE_GDB=y
BR2_PACKAGE_BITSTREAM_VERA=y
BR2_PACKAGE_MESA3D=y
BR2_PACKAGE_MESA3D_GALLIUM_DRIVER_V3D=y
BR2_PACKAGE_MESA3D_OPENGL_ES=y
BR2_PACKAGE_BRCMFMAC_SDIO_FIRMWARE_RPI=y
BR2_PACKAGE_BRCMFMAC_SDIO_FIRMWARE_RPI_BT=y
BR2_PACKAGE_BRCMFMAC_SDIO_FIRMWARE_RPI_WIFI=y
BR2_PACKAGE_RPI_FIRMWARE=y
BR2_PACKAGE_RPI_FIRMWARE_VARIANT_PI4=y
BR2_PACKAGE_RPI_FIRMWARE_CONFIG_FILE="${BR2_EXTERNAL_ML_OSS_PATH}/board/raspberrypi4/config.txt"
BR2_PACKAGE_CAIRO_SVG=y
BR2_PACKAGE_LIBCURL_CURL=y
BR2_PACKAGE_LIBSOUP=y
BR2_PACKAGE_LIBSOUP_SSL=y
BR2_PACKAGE_GOOGLEFONTDIRECTORY=y
BR2_PACKAGE_DROPBEAR=y
BR2_PACKAGE_RSYNC=y
BR2_PACKAGE_WPA_SUPPLICANT_AP_SUPPORT=y
BR2_PACKAGE_WPA_SUPPLICANT_MESH_NETWORKING=y
BR2_PACKAGE_WPA_SUPPLICANT_AUTOSCAN=y
BR2_PACKAGE_WPA_SUPPLICANT_EAP=y
BR2_PACKAGE_WPA_SUPPLICANT_WPA3=y
BR2_PACKAGE_WPA_SUPPLICANT_CLI=y
BR2_PACKAGE_WPA_SUPPLICANT_WPA_CLIENT_SO=y
BR2_PACKAGE_WPA_SUPPLICANT_PASSPHRASE=y
BR2_TARGET_ROOTFS_EXT2=y
BR2_TARGET_ROOTFS_EXT2_4=y
BR2_TARGET_ROOTFS_EXT2_SIZE="400M"
# BR2_TARGET_ROOTFS_TAR is not set
BR2_PACKAGE_HOST_CMAKE=y
BR2_PACKAGE_HOST_DOSFSTOOLS=y
BR2_PACKAGE_HOST_GENIMAGE=y
BR2_PACKAGE_HOST_MTOOLS=y
BR2_PACKAGE_KMS_CUBE=y
BR2_PACKAGE_WPEFRAMEWORK_BUILD_TYPE_DEBUG=y
BR2_PACKAGE_WPEFRAMEWORK_PERSISTENT_PATH="/root"
BR2_PACKAGE_WPEFRAMEWORK_MESSAGING=y
BR2_PACKAGE_WPEFRAMEWORK_UMASK="000"
BR2_PACKAGE_WPEFRAMEWORK_CLIENTLIBRARY_BLUETOOTHAUDIOSINK=y
BR2_PACKAGE_WPEFRAMEWORK_CLIENTLIBRARY_CRYPTOGRAPHY=y
BR2_PACKAGE_WPEFRAMEWORK_BLUETOOTHREMOTECONTROL=y
BR2_PACKAGE_WPEFRAMEWORK_COMPOSITOR=y
BR2_PACKAGE_WPEFRAMEWORK_COMPOSITOR_RESOLUTION_1080P=y
BR2_PACKAGE_WPEFRAMEWORK_DEVICEINFO=y
BR2_PACKAGE_WPEFRAMEWORK_DISPLAYINFO=y
BR2_PACKAGE_WPEFRAMEWORK_DHCPSERVER=y
BR2_PACKAGE_WPEFRAMEWORK_LOCATIONSYNC=y
BR2_PACKAGE_WPEFRAMEWORK_REMOTECONTROL=y
BR2_PACKAGE_WPEFRAMEWORK_TIMESYNC=y
BR2_PACKAGE_WPEFRAMEWORK_MESSAGECONTROL=y
BR2_PACKAGE_WPEFRAMEWORK_WEBKITBROWSER=y
BR2_PACKAGE_WPEFRAMEWORK_WEBKITBROWSER_USER="wpewebkit"
BR2_PACKAGE_WPEFRAMEWORK_WEBKITBROWSER_GROUP="wpewebkit"
BR2_PACKAGE_WPEFRAMEWORK_WIFICONTROL=y
BR2_PACKAGE_WESTEROS=y
BR2_PACKAGE_WPEWEBKIT_ML=y
```

## configs/raspberrypi4_debug_defconfig
```kconfig
BR2_arm=y
BR2_cortex_a72=y
BR2_ARM_FPU_NEON_VFPV4=y
BR2_ARM_INSTRUCTIONS_THUMB2=y
BR2_CCACHE=y
BR2_ENABLE_DEBUG=y
BR2_DEBUG_3=y
BR2_OPTIMIZE_0=y
BR2_TOOLCHAIN_BUILDROOT_GLIBC=y
BR2_TOOLCHAIN_BUILDROOT_CXX=y
BR2_ROOTFS_DEVICE_CREATION_DYNAMIC_EUDEV=y
BR2_TARGET_GENERIC_ROOT_PASSWD="root"
BR2_ROOTFS_POST_BUILD_SCRIPT="${BR2_EXTERNAL_ML_OSS_PATH}/board/raspberrypi4/post-build.sh"
BR2_ROOTFS_POST_IMAGE_SCRIPT="${BR2_EXTERNAL_ML_OSS_PATH}/board/raspberrypi4/post-image.sh"
BR2_ROOTFS_POST_SCRIPT_ARGS="--add-pi3-miniuart-bt-overlay --add-vc4-kms-v3d-overlay"
BR2_LINUX_KERNEL=y
BR2_LINUX_KERNEL_CUSTOM_TARBALL=y
BR2_LINUX_KERNEL_CUSTOM_TARBALL_LOCATION="$(call github,raspberrypi,linux,4ce3961c5794c1937d3bb4716eb355bc9e12c445)/linux-4ce3961c5794c1937d3bb4716eb355bc9e12c445.tar.gz"
BR2_LINUX_KERNEL_USE_CUSTOM_CONFIG=y
BR2_LINUX_KERNEL_CUSTOM_CONFIG_FILE="$(BR2_EXTERNAL_ML_OSS_PATH)/board/raspberrypi/rpi34-linux-6.1.config"
BR2_LINUX_KERNEL_LZ4=y
BR2_LINUX_KERNEL_DTS_SUPPORT=y
BR2_LINUX_KERNEL_INTREE_DTS_NAME="bcm2711-rpi-4-b"
BR2_PACKAGE_KMSCUBE=y
BR2_PACKAGE_MESA3D=y
BR2_PACKAGE_MESA3D_GALLIUM_DRIVER_KMSRO=y
BR2_PACKAGE_MESA3D_GALLIUM_DRIVER_V3D=y
BR2_PACKAGE_MESA3D_GALLIUM_DRIVER_VC4=y
BR2_PACKAGE_MESA3D_OPENGL_ES=y
BR2_PACKAGE_LINUX_FIRMWARE=y
BR2_PACKAGE_LINUX_FIRMWARE_RALINK_RT2XX=y
BR2_PACKAGE_RPI_FIRMWARE=y
BR2_PACKAGE_RPI_FIRMWARE_VARIANT_PI4=y
BR2_PACKAGE_OPENSSL=y
BR2_PACKAGE_LIBYXOPE=y
BR2_PACKAGE_DROPBEAR=y
BR2_PACKAGE_WPEWEBKIT=n

# Enable compressed kernel module support
BR2_PACKAGE_BUSYBOX_SHOW_OTHERS
BR2_PACKAGE_KMOD_TOOLS
BR2_PACKAGE_XZ
BR2_PACKAGE_KMOD
BR2_PACKAGE_HOST_KMOD_XZ
```

## configs/raspberrypi_arm64_thunder_defconfig
```kconfig
BR2_aarch64=y
BR2_TOOLCHAIN_EXTERNAL=y
BR2_CCACHE=y
BR2_GLOBAL_PATCH_DIR="$(BR2_EXTERNAL_ML_OSS_PATH)/patches"
BR2_ROOTFS_DEVICE_CREATION_DYNAMIC_EUDEV=y
BR2_TARGET_GENERIC_ROOT_PASSWD="root"
BR2_ROOTFS_POST_BUILD_SCRIPT="$(BR2_EXTERNAL_ML_OSS_PATH)/board/raspberrypi/post-build.sh"
BR2_ROOTFS_POST_IMAGE_SCRIPT="$(BR2_EXTERNAL_ML_OSS_PATH)/board/raspberrypi/post-image.sh"
BR2_ROOTFS_POST_SCRIPT_ARGS="--rpi-wifi --silent --hdmi-console  --mount-boot --install-ssh-id"
BR2_LINUX_KERNEL=y
BR2_LINUX_KERNEL_CUSTOM_TARBALL=y
BR2_LINUX_KERNEL_CUSTOM_TARBALL_LOCATION="$(call github,raspberrypi,linux,fbd8b3facb36ce888b1cdcf5f45a78475a8208f2)/linux-fbd8b3facb36ce888b1cdcf5f45a78475a8208f2.tar.gz"
BR2_LINUX_KERNEL_DEFCONFIG="bcm2711"
BR2_LINUX_KERNEL_LZ4=y
BR2_LINUX_KERNEL_DTS_SUPPORT=y
BR2_LINUX_KERNEL_INTREE_DTS_NAME="broadcom/bcm2710-rpi-cm3 broadcom/bcm2711-rpi-400  broadcom/bcm2711-rpi-cm4-io broadcom/bcm2837-rpi-3-a-plus broadcom/bcm2837-rpi-cm3-io3 broadcom/bcm2710-rpi-3-b broadcom/bcm2710-rpi-zero-2 broadcom/bcm2711-rpi-4-b  broadcom/bcm2711-rpi-cm4s broadcom/bcm2837-rpi-3-b broadcom/bcm2837-rpi-zero-2-w broadcom/bcm2710-rpi-3-b-plus broadcom/bcm2710-rpi-zero-2-w  broadcom/bcm2711-rpi-cm4 broadcom/bcm2712-rpi-5-b broadcom/bcm2837-rpi-3-b-plus"
BR2_LINUX_KERNEL_NEEDS_HOST_OPENSSL=y
BR2_PACKAGE_BUSYBOX_SHOW_OTHERS=y
BR2_PACKAGE_XZ=y
BR2_PACKAGE_BRCMFMAC_SDIO_FIRMWARE_RPI=y
BR2_PACKAGE_BRCMFMAC_SDIO_FIRMWARE_RPI_BT=y
BR2_PACKAGE_BRCMFMAC_SDIO_FIRMWARE_RPI_WIFI=y
BR2_PACKAGE_RPI_FIRMWARE=y
BR2_PACKAGE_RPI_FIRMWARE_BOOTCODE_BIN=y
BR2_PACKAGE_RPI_FIRMWARE_VARIANT_PI=y
BR2_PACKAGE_RPI_FIRMWARE_VARIANT_PI4=y
BR2_PACKAGE_RPI_FIRMWARE_CONFIG_FILE="$(BR2_EXTERNAL_ML_OSS_PATH)/board/raspberrypi/generic-config.txt"
BR2_PACKAGE_OPENSSL=y
BR2_PACKAGE_LIBCURL=y
BR2_PACKAGE_LIBCURL_CURL=y
BR2_PACKAGE_DROPBEAR=y
BR2_PACKAGE_RSYNC=y
BR2_PACKAGE_WPA_SUPPLICANT_AP_SUPPORT=y
BR2_PACKAGE_WPA_SUPPLICANT_WPS=y
BR2_PACKAGE_WPA_SUPPLICANT_CTRL_IFACE=y
BR2_PACKAGE_KMOD_TOOLS=y
BR2_TARGET_ROOTFS_EXT2=y
BR2_TARGET_ROOTFS_EXT2_4=y
BR2_TARGET_ROOTFS_EXT2_SIZE="80M"
BR2_PACKAGE_HOST_CMAKE=y
BR2_PACKAGE_HOST_DOSFSTOOLS=y
BR2_PACKAGE_HOST_GENIMAGE=y
BR2_PACKAGE_HOST_KMOD_XZ=y
BR2_PACKAGE_HOST_MTOOLS=y
BR2_PACKAGE_THUNDER_MESSAGING=y
BR2_PACKAGE_THUNDER_ENABLE_ENVIRONMENT=y
# BR2_PACKAGE_THUNDER_CLIENTLIBRARY_COMPOSITORCLIENT is not set
BR2_PACKAGE_THUNDER_BLUETOOTH=y
BR2_PACKAGE_THUNDER_CLIENTLIBRARY_CRYPTOGRAPHY=y
BR2_PACKAGE_THUNDER_DEVICEINFO=y
BR2_PACKAGE_THUNDER_DHCPSERVER=y
BR2_PACKAGE_THUNDER_LOCATIONSYNC=y
BR2_PACKAGE_THUNDER_MESSAGECONTROL=y
BR2_PACKAGE_THUNDER_TIMESYNC=y
BR2_PACKAGE_THUNDER_WIFICONTROL=y
```

## configs/raspberrypi_armhf_thunder_defconfig
```kconfig
BR2_arm=y
BR2_cortex_a53=y
BR2_ARM_FPU_NEON_VFPV4=y
BR2_ARM_INSTRUCTIONS_THUMB2=y
BR2_TOOLCHAIN_EXTERNAL=y
BR2_CCACHE=y
BR2_GLOBAL_PATCH_DIR="${BR2_EXTERNAL_ML_OSS_PATH}/patches"
BR2_ROOTFS_DEVICE_CREATION_DYNAMIC_EUDEV=y
BR2_TARGET_GENERIC_ROOT_PASSWD="root"
BR2_ROOTFS_POST_BUILD_SCRIPT="${BR2_EXTERNAL_ML_OSS_PATH}/board/raspberrypi/post-build.sh"
BR2_ROOTFS_POST_IMAGE_SCRIPT="${BR2_EXTERNAL_ML_OSS_PATH}/board/raspberrypi/post-image.sh"
BR2_ROOTFS_POST_SCRIPT_ARGS="--rpi-wifi --silent --hdmi-console --mount-boot --install-ssh-id"
BR2_LINUX_KERNEL=y
BR2_LINUX_KERNEL_CUSTOM_TARBALL=y
BR2_LINUX_KERNEL_CUSTOM_TARBALL_LOCATION="$(call github,raspberrypi,linux,fbd8b3facb36ce888b1cdcf5f45a78475a8208f2)/linux-fbd8b3facb36ce888b1cdcf5f45a78475a8208f2.tar.gz"
BR2_LINUX_KERNEL_DEFCONFIG="bcm2711"
BR2_LINUX_KERNEL_LZ4=y
BR2_LINUX_KERNEL_DTS_SUPPORT=y
BR2_LINUX_KERNEL_INTREE_DTS_NAME="bcm2710-rpi-3-b bcm2710-rpi-3-b-plus bcm2710-rpi-cm3 bcm2710-rpi-zero-2 bcm2710-rpi-zero-2-w bcm2711-rpi-400 bcm2711-rpi-4-b bcm2711-rpi-cm4 bcm2711-rpi-cm4-io bcm2711-rpi-cm4s"
BR2_LINUX_KERNEL_NEEDS_HOST_OPENSSL=y
BR2_PACKAGE_BUSYBOX_SHOW_OTHERS=y
BR2_PACKAGE_XZ=y
BR2_PACKAGE_BRCMFMAC_SDIO_FIRMWARE_RPI=y
BR2_PACKAGE_BRCMFMAC_SDIO_FIRMWARE_RPI_BT=y
BR2_PACKAGE_BRCMFMAC_SDIO_FIRMWARE_RPI_WIFI=y
BR2_PACKAGE_RPI_FIRMWARE=y
BR2_PACKAGE_RPI_FIRMWARE_BOOTCODE_BIN=y
BR2_PACKAGE_RPI_FIRMWARE_VARIANT_PI=y
BR2_PACKAGE_RPI_FIRMWARE_VARIANT_PI4=y
BR2_PACKAGE_RPI_FIRMWARE_CONFIG_FILE="$(BR2_EXTERNAL_ML_OSS_PATH)/board/raspberrypi/generic-config.txt"
BR2_PACKAGE_OPENSSL=y
BR2_PACKAGE_LIBCURL=y
BR2_PACKAGE_LIBCURL_CURL=y
BR2_PACKAGE_DROPBEAR=y
BR2_PACKAGE_RSYNC=y
BR2_PACKAGE_WPA_SUPPLICANT_AP_SUPPORT=y
BR2_PACKAGE_WPA_SUPPLICANT_WPS=y
BR2_PACKAGE_WPA_SUPPLICANT_CTRL_IFACE=y
BR2_PACKAGE_KMOD_TOOLS=y
BR2_TARGET_ROOTFS_EXT2=y
BR2_TARGET_ROOTFS_EXT2_4=y
BR2_TARGET_ROOTFS_EXT2_SIZE="80M"
BR2_PACKAGE_HOST_CMAKE=y
BR2_PACKAGE_HOST_DOSFSTOOLS=y
BR2_PACKAGE_HOST_GENIMAGE=y
BR2_PACKAGE_HOST_KMOD_XZ=y
BR2_PACKAGE_HOST_MTOOLS=y
BR2_PACKAGE_THUNDER_MESSAGING=y
# BR2_PACKAGE_THUNDER_CLIENTLIBRARY_COMPOSITORCLIENT is not set
BR2_PACKAGE_THUNDER_BLUETOOTH=y
BR2_PACKAGE_THUNDER_CLIENTLIBRARY_CRYPTOGRAPHY=y
BR2_PACKAGE_THUNDER_DEVICEINFO=y
BR2_PACKAGE_THUNDER_DHCPSERVER=y
BR2_PACKAGE_THUNDER_LOCATIONSYNC=y
BR2_PACKAGE_THUNDER_MESSAGECONTROL=y
BR2_PACKAGE_THUNDER_TIMESYNC=y
BR2_PACKAGE_THUNDER_WIFICONTROL=y
```

## package/Config.in
```kconfig
source "$BR2_EXTERNAL_ML_OSS_PATH/package/amazon-alexa-opensource/Config.in"
source "$BR2_EXTERNAL_ML_OSS_PATH/package/blits-example-app/Config.in"
source "$BR2_EXTERNAL_ML_OSS_PATH/package/bun/Config.in"
source "$BR2_EXTERNAL_ML_OSS_PATH/package/cobalt/Config.in"
source "$BR2_EXTERNAL_ML_OSS_PATH/package/gyp/Config.in"
source "$BR2_EXTERNAL_ML_OSS_PATH/package/ggml/Config.in"
source "$BR2_EXTERNAL_ML_OSS_PATH/package/kms-cube/Config.in"
source "$BR2_EXTERNAL_ML_OSS_PATH/package/libdash/Config.in"
source "$BR2_EXTERNAL_ML_OSS_PATH/package/libdrm-examples/Config.in"
source "$BR2_EXTERNAL_ML_OSS_PATH/package/llama/Config.in"
source "$BR2_EXTERNAL_ML_OSS_PATH/package/ssl-key/Config.in"
source "$BR2_EXTERNAL_ML_OSS_PATH/package/rdksplashscreen/Config.in"
source "$BR2_EXTERNAL_ML_OSS_PATH/package/thunder-opensource/Config.in"
source "$BR2_EXTERNAL_ML_OSS_PATH/package/westeros/Config.in"
source "$BR2_EXTERNAL_ML_OSS_PATH/package/wpebackend/Config.in"
source "$BR2_EXTERNAL_ML_OSS_PATH/package/wpebackend-rdk/Config.in"
source "$BR2_EXTERNAL_ML_OSS_PATH/package/wpewebkit-ml/Config.in"
source "$BR2_EXTERNAL_ML_OSS_PATH/package/linux-binder-idl/Config.in"
source "$BR2_EXTERNAL_ML_OSS_PATH/package/binder/Config.in"

if BR2_PACKAGE_GSTREAMER1
source "$BR2_EXTERNAL_ML_OSS_PATH/package/gst1-bluetoothaudiosink/Config.in"
source "$BR2_EXTERNAL_ML_OSS_PATH/package/gst1-bluetoothaudiosource/Config.in"
endif
```

## package/air-ui-example-app/Config.in
```kconfig
config BR2_PACKAGE_BLITS_EXAMPLE_APP
    bool "air-ui-example-app"
    select BR2_PACKAGE_HOST_NODEJS
    help
        Example Air UI Lightning 3 App

        https://github.com/erikhaandrikman/air-ui
```

## package/amazon-alexa-opensource/Config.in
```kconfig
menu "amazon alexa"
source "$BR2_EXTERNAL_ML_OSS_PATH/package/amazon-alexa-opensource/alexa-smart-screen-sdk/Config.in"
source "$BR2_EXTERNAL_ML_OSS_PATH/package/amazon-alexa-opensource/apl-client-library/Config.in"
source "$BR2_EXTERNAL_ML_OSS_PATH/package/amazon-alexa-opensource/apl-core-library/Config.in"
source "$BR2_EXTERNAL_ML_OSS_PATH/package/amazon-alexa-opensource/avs-device-sdk/Config.in"
endmenu
```

## package/binder/Config.in
```kconfig
config BR2_PACKAGE_BINDER
	bool "binder"
	help
	  Low level Binder library and tools.
```

## package/blits-example-app/Config.in
```kconfig
config BR2_PACKAGE_BLITS_EXAMPLE_APP
    bool "blits-example-app"
    select BR2_PACKAGE_HOST_NODEJS
    help
        Example Blits Lightning 3 App

        https://github.com/lightning-js/blits-example-app
```

## package/bun/Config.in
```kconfig
config BR2_PACKAGE_BUN
	bool "bun"
 	select BR2_PACKAGE_HOST_RUSTC
        select BR2_PACKAGE_LIBDEFLATE
        select BR2_PACKAGE_ZLIB
        select BR2_PACKAGE_LIBARCHIVE
        select BR2_PACKAGE_ZSTD
        select BR2_PACKAGE_BROTLI
        select BR2_PACKAGE_C_ARES
	help
          Bun is a JavaScript runtime.

	  https://bun.sh/
```

## package/ggml/Config.in
```kconfig
config BR2_PACKAGE_GGML
	bool "ggml"
        depends on BR2_GCC_ENABLE_OPENMP

comment "ggml needs a toolchain with OpenMP support"
        depends on !BR2_GCC_ENABLE_OPENMP
```

## package/gn/Config.in
```kconfig
config BR2_PACKAGE_GN
	bool "ng"
	help
	  GN is a meta-build system that generates build files for 
	  Ninja. GN is currently used as the build system for 
	  Chromium, Fuchsia, and related projects.

	  https://gn.googlesource.com/gn
```

## package/kms-cube/Config.in
```kconfig
config BR2_PACKAGE_KMS_CUBE
	bool "kms-cube"
	# requires libgbm from mesa3d
	depends on BR2_PACKAGE_HAS_LIBEGL
	depends on BR2_PACKAGE_HAS_LIBGLES
	help
	  kmscube is an application to test kms/drm drivers.

	  https://gitlab.freedesktop.org/mesa/kmscube
```

## package/linux-binder-idl/Config.in
```kconfig
config BR2_PACKAGE_LINUX_BINDER_IDL
    bool "linux-binder-idl"
    help
      Android Binder IPC and AIDL toolchain ported to Linux.
      Based on rdkcentral/linux_binder_idl (AOSP 13).


if BR2_PACKAGE_BINDER
config BR2_LINUX_KERNEL_CONFIG_FRAGMENT_FILES
    string
    default "package/binder/binder_kernel.fragment"
endif
```

## package/llama/Config.in
```kconfig
config BR2_PACKAGE_LLAMA
	bool "llama"
        depends on BR2_GCC_ENABLE_OPENMP

comment "llama needs a toolchain with OpenMP support"
        depends on !BR2_GCC_ENABLE_OPENMP
```
