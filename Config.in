## Config.in
```kconfig
source "$BR2_EXTERNAL_ML_OSS_PATH/adaptation/Config.in"
source "$BR2_EXTERNAL_ML_OSS_PATH/package/Config.in"
```

## adaptation/Config.in
```kconfig
menu "buildroot adaptations"
source "$BR2_EXTERNAL_ML_OSS_PATH/adaptation/gst1-plugins-base/Config.in"
source "$BR2_EXTERNAL_ML_OSS_PATH/adaptation/dropbear/Config.in"
endmenu
```

## adaptation/cairo/Config.in
```kconfig
menu "cairo"
config BR2_PACKAGE_CAIRO_ENABLE_GLES_BACKEND
	bool "Enable GLES support"
	depends on BR2_PACKAGE_CAIRO
	depends on BR2_PACKAGE_HAS_LIBEGL
	depends on BR2_PACKAGE_HAS_LIBGLES
	help
	  Enable support for the GLES backend in Cairo.

	  This is needed for WPE Webkit < v2.46, which requires the EGL/GLES backend 

comment "cairo-gles2 needs the GLES platform and cairo"
	depends on !BR2_PACKAGE_CAIRO || !BR2_PACKAGE_HAS_LIBEGL || !BR2_PACKAGE_HAS_LIBGLES
endmenu
```

## adaptation/dropbear/Config.in
```kconfig
menu "dropbear"
config BR2_PACKAGE_DROPBEAR_LIBDROPBEAR_SUPPORT
	bool "libdropbear"
	depends on BR2_PACKAGE_DROPBEAR
	help
	  GBM windowing system

comment "libdropbear needs dropbear"
	depends on (!BR2_PACKAGE_DROPBEAR)

endmenu
```

## adaptation/gst1-plugins-base/Config.in
```kconfig
menu "gst1-plugins-base"
config BR2_PACKAGE_GST1_PLUGINS_BASE_LIB_OPENGL_LIBGBM
	bool "opengl gbm winsys"
	depends on BR2_PACKAGE_GST1_PLUGINS_BASE_LIB_OPENGL_EGL
	depends on BR2_PACKAGE_HAS_LIBGBM
	depends on !BR2_PACKAGE_WAYLAND
	depends on !BR2_PACKAGE_XORG7
	select BR2_PACKAGE_GST1_PLUGINS_BASE_LIB_OPENGL_HAS_WINDOW
	select BR2_PACKAGE_LIBGUDEV
	help
	  GBM windowing system

comment "gst1-plugins-base-gbm needs the egl platform and libgbm"
	depends on !BR2_PACKAGE_GST1_PLUGINS_BASE_LIB_OPENGL_EGL || \
		!BR2_PACKAGE_HAS_LIBGBM || BR2_PACKAGE_WAYLAND || BR2_PACKAGE_XORG7

config BR2_PACKAGE_GST1_PLUGINS_BASE_LIB_OPENGL_LIBEGL
	bool "opengl egl winsys"
	depends on BR2_PACKAGE_GST1_PLUGINS_BASE_LIB_OPENGL_EGL
	depends on !BR2_PACKAGE_WAYLAND
	depends on !BR2_PACKAGE_XORG7
	select BR2_PACKAGE_GST1_PLUGINS_BASE_LIB_OPENGL_HAS_WINDOW
	help
	  EGL windowing system

comment "gst1-plugins-base-egl needs the egl platform"
	depends on (!BR2_PACKAGE_GST1_PLUGINS_BASE_LIB_OPENGL_EGL || \
		!BR2_PACKAGE_HAS_LIBGBM || BR2_PACKAGE_WAYLAND || BR2_PACKAGE_XORG7)

endmenu
```

## configs/bpi-m2-plus_compositor_defconfig
```kconfig
BR2_arm=y
BR2_cortex_a7=y
BR2_ARM_FPU_NEON_VFPV4=y
BR2_ARM_INSTRUCTIONS_THUMB2=y
BR2_TOOLCHAIN_BUILDROOT_CXX=y
BR2_PACKAGE_HOST_GDB=y
BR2_CCACHE=y
BR2_ENABLE_DEBUG=y
BR2_STRIP_EXCLUDE_FILES="*WPEFramework* libcompositorplugin.so"
BR2_STRIP_EXCLUDE_DIRS="usr/bin/WPEFrameworkTests"
BR2_OPTIMIZE_G=y
BR2_ROOTFS_DEVICE_CREATION_DYNAMIC_EUDEV=y
BR2_TARGET_GENERIC_ROOT_PASSWD="root"
BR2_SYSTEM_DHCP="eth0"
BR2_ROOTFS_OVERLAY=" ${BR2_EXTERNAL_ML_OSS_PATH}/board/bananapi-m2-plus/rootfs-overlay"
BR2_ROOTFS_POST_BUILD_SCRIPT="$(BR2_EXTERNAL_ML_OSS_PATH)/board/bananapi-m2-plus/post-build.sh"
BR2_ROOTFS_POST_IMAGE_SCRIPT="support/scripts/genimage.sh"
BR2_ROOTFS_POST_SCRIPT_ARGS="-c ${BR2_EXTERNAL_ML_OSS_PATH}/board/bananapi-m2-plus/genimage.cfg -- --hdmi-console --install-ssh-id  --ttyS0-console"
BR2_LINUX_KERNEL=y
BR2_LINUX_KERNEL_PATCH=" ${BR2_EXTERNAL_ML_OSS_PATH}/board/bananapi-m2-plus/patches/linux"
BR2_LINUX_KERNEL_USE_CUSTOM_CONFIG=y
BR2_LINUX_KERNEL_CUSTOM_CONFIG_FILE="${BR2_EXTERNAL_ML_OSS_PATH}/board/bananapi-m2-plus/linux-arm_defconfig"
BR2_LINUX_KERNEL_DTS_SUPPORT=y
BR2_LINUX_KERNEL_INTREE_DTS_NAME="allwinner/sun8i-h3-bananapi-m2-plus"
BR2_LINUX_KERNEL_INSTALL_TARGET=y
BR2_LINUX_KERNEL_NEEDS_HOST_OPENSSL=y
BR2_PACKAGE_GST1_PLUGINS_BASE_PLUGIN_APP=y
BR2_PACKAGE_GST1_PLUGINS_BASE_PLUGIN_AUDIOTESTSRC=y
BR2_PACKAGE_GST1_PLUGINS_BASE_PLUGIN_GIO=y
BR2_PACKAGE_GST1_PLUGINS_BASE_PLUGIN_VIDEOTESTSRC=y
BR2_PACKAGE_GST1_PLUGINS_BASE_PLUGIN_VIDEORATE=y
BR2_PACKAGE_GST1_PLUGINS_BASE_LIB_OPENGL=y
BR2_PACKAGE_GST1_PLUGINS_BASE_PLUGIN_ALSA=y
BR2_PACKAGE_GST1_PLUGINS_BASE_PLUGIN_TREMOR=y
BR2_PACKAGE_GST1_PLUGINS_BASE_PLUGIN_OGG=y
BR2_PACKAGE_GST1_PLUGINS_BASE_PLUGIN_OPUS=y
BR2_PACKAGE_GST1_PLUGINS_BASE_PLUGIN_VORBIS=y
BR2_PACKAGE_GST1_PLUGINS_GOOD_PLUGIN_ALPHA=y
BR2_PACKAGE_GST1_PLUGINS_GOOD_PLUGIN_AUDIOFX=y
BR2_PACKAGE_GST1_PLUGINS_GOOD_PLUGIN_AUDIOPARSERS=y
BR2_PACKAGE_GST1_PLUGINS_GOOD_PLUGIN_AUTODETECT=y
BR2_PACKAGE_GST1_PLUGINS_GOOD_PLUGIN_DEINTERLACE=y
BR2_PACKAGE_GST1_PLUGINS_GOOD_PLUGIN_ICYDEMUX=y
BR2_PACKAGE_GST1_PLUGINS_GOOD_PLUGIN_ID3DEMUX=y
BR2_PACKAGE_GST1_PLUGINS_GOOD_PLUGIN_INTERLEAVE=y
BR2_PACKAGE_GST1_PLUGINS_GOOD_PLUGIN_MATROSKA=y
BR2_PACKAGE_GST1_PLUGINS_GOOD_PLUGIN_VIDEOCROP=y
BR2_PACKAGE_GST1_PLUGINS_GOOD_PLUGIN_VIDEOFILTER=y
BR2_PACKAGE_GST1_PLUGINS_GOOD_PLUGIN_MPG123=y
BR2_PACKAGE_GST1_PLUGINS_GOOD_PLUGIN_V4L2=y
BR2_PACKAGE_GST1_PLUGINS_GOOD_PLUGIN_V4L2_PROBE=y
BR2_PACKAGE_GST1_PLUGINS_GOOD_PLUGIN_PULSE=y
BR2_PACKAGE_GST1_PLUGINS_GOOD_PLUGIN_SOUPHTTPSRC=y
BR2_PACKAGE_GST1_PLUGINS_GOOD_PLUGIN_VPX=y
BR2_PACKAGE_GST1_PLUGINS_BAD_PLUGIN_MPEGTSDEMUX=y
BR2_PACKAGE_GST1_PLUGINS_BAD_PLUGIN_SUBENC=y
BR2_PACKAGE_GST1_PLUGINS_BAD_PLUGIN_VIDEOPARSERS=y
BR2_PACKAGE_GST1_PLUGINS_BAD_PLUGIN_DASH=y
BR2_PACKAGE_GST1_PLUGINS_BAD_PLUGIN_FAAD=y
BR2_PACKAGE_GST1_PLUGINS_BAD_PLUGIN_FDK_AAC=y
BR2_PACKAGE_GST1_PLUGINS_BAD_PLUGIN_HLS=y
BR2_PACKAGE_GST1_PLUGINS_BAD_PLUGIN_KMS=y
BR2_PACKAGE_GST1_PLUGINS_BAD_PLUGIN_OPENH264=y
BR2_PACKAGE_GST1_PLUGINS_BAD_PLUGIN_OPUS=y
BR2_PACKAGE_GST1_PLUGINS_BAD_PLUGIN_WEBP=y
BR2_PACKAGE_GST1_PLUGINS_BAD_PLUGIN_V4L2CODECS=y
BR2_PACKAGE_GDB=y
BR2_PACKAGE_BITSTREAM_VERA=y
BR2_PACKAGE_KMSCUBE=y
BR2_PACKAGE_LIBVA_UTILS=y
BR2_PACKAGE_MESA3D=y
BR2_PACKAGE_MESA3D_GALLIUM_DRIVER_LIMA=y
BR2_PACKAGE_MESA3D_OPENGL_EGL=y
BR2_PACKAGE_MESA3D_OPENGL_ES=y
BR2_PACKAGE_LINUX_FIRMWARE=y
BR2_PACKAGE_LINUX_FIRMWARE_BRCM_BCM43XXX=y
BR2_PACKAGE_LIBDRM_VC4=y
BR2_PACKAGE_LIBDRM_INSTALL_TESTS=y
BR2_PACKAGE_LIBV4L=y
BR2_PACKAGE_C_ARES=y
BR2_PACKAGE_LIBCURL=y
BR2_PACKAGE_LIBCURL_CURL=y
BR2_PACKAGE_LIBSOUP3=y
BR2_PACKAGE_LIBSOUP3_SSL=y
BR2_PACKAGE_ORC=y
BR2_PACKAGE_SHARED_MIME_INFO=y
BR2_PACKAGE_DROPBEAR=y
BR2_PACKAGE_RSYNC=y
BR2_PACKAGE_WPA_SUPPLICANT_IBSS_RSN=y
BR2_PACKAGE_WPA_SUPPLICANT_AP_SUPPORT=y
BR2_PACKAGE_WPA_SUPPLICANT_WIFI_DISPLAY=y
BR2_PACKAGE_WPA_SUPPLICANT_MESH_NETWORKING=y
BR2_PACKAGE_WPA_SUPPLICANT_AUTOSCAN=y
BR2_PACKAGE_WPA_SUPPLICANT_WPS=y
BR2_PACKAGE_WPA_SUPPLICANT_WPA3=y
BR2_PACKAGE_WPA_SUPPLICANT_CTRL_IFACE=y
BR2_TARGET_ROOTFS_EXT2=y
BR2_TARGET_ROOTFS_EXT2_4=y
BR2_TARGET_ROOTFS_EXT2_SIZE="500M"
# BR2_TARGET_ROOTFS_TAR is not set
BR2_TARGET_UBOOT=y
BR2_TARGET_UBOOT_BOARDNAME="bananapi_m2_plus_h3"
BR2_TARGET_UBOOT_CUSTOM_VERSION=y
BR2_TARGET_UBOOT_CUSTOM_VERSION_VALUE="2024.01"
BR2_TARGET_UBOOT_NEEDS_DTC=y
BR2_TARGET_UBOOT_NEEDS_PYLIBFDT=y
BR2_TARGET_UBOOT_FORMAT_CUSTOM=y
BR2_TARGET_UBOOT_FORMAT_CUSTOM_NAME="u-boot-sunxi-with-spl.bin"
BR2_PACKAGE_HOST_DOSFSTOOLS=y
BR2_PACKAGE_HOST_GENIMAGE=y
BR2_PACKAGE_HOST_MTOOLS=y
BR2_PACKAGE_BLITS_EXAMPLE_APP=y
BR2_PACKAGE_WPEFRAMEWORK_BUILD_TYPE_DEBUG=y
BR2_PACKAGE_WPEFRAMEWORK_TRACE_LEVEL_3=y
BR2_PACKAGE_WPEFRAMEWORK_MESSAGING=y
BR2_PACKAGE_WPEFRAMEWORK_TRACING_MODULES="Composition_Client Plugin_Screensaver Plugin_Compositor CompositorRenderEGL CompositorBackendOff CompositorBuffer DRMCommon CompositorRendererOff CompositorMesaImplementation"
BR2_PACKAGE_WPEFRAMEWORK_CLIENTLIBRARY_DEVICEINFO=y
BR2_PACKAGE_WPEFRAMEWORK_CLIENTLIBRARY_DISPLAYINFO=y
BR2_PACKAGE_WPEFRAMEWORK_CLIENTLIBRARY_CRYPTOGRAPHY=y
BR2_PACKAGE_WPEFRAMEWORK_COMPOSITOR=y
BR2_PACKAGE_WPEFRAMEWORK_COMPOSITOR_EXPERIMENTAL=y
BR2_PACKAGE_WPEFRAMEWORK_DHCPSERVER=y
BR2_PACKAGE_WPEFRAMEWORK_LOCATIONSYNC=y
BR2_PACKAGE_WPEFRAMEWORK_LOCATIONSYNC_URI="http://jsonip.metrological.com/?maf=true"
BR2_PACKAGE_WPEFRAMEWORK_MESSAGECONTROL=y
BR2_PACKAGE_WPEFRAMEWORK_MONITOR=y
BR2_PACKAGE_WPEFRAMEWORK_REMOTECONTROL=y
BR2_PACKAGE_WPEFRAMEWORK_REMOTECONTROL_DEVINPUT=y
BR2_PACKAGE_WPEFRAMEWORK_SUBSYSTEMCONTROLLER=y
BR2_PACKAGE_WPEFRAMEWORK_TIMESYNC=y
BR2_PACKAGE_WPEFRAMEWORK_WEBKITBROWSER=y
BR2_PACKAGE_WPEFRAMEWORK_WEBKITBROWSER_MEMORYPRESSURE="databaseprocess:50m,networkprocess:80m,webprocess:250m,rpcprocess:80m"
BR2_PACKAGE_WPEFRAMEWORK_WEBKITBROWSER_DISKCACHE="512m"
BR2_PACKAGE_WPEFRAMEWORK_WEBKITBROWSER_XHRCACHE=y
BR2_PACKAGE_WPEFRAMEWORK_WEBKITBROWSER_THREADEDPAINTING="2"
BR2_PACKAGE_WPEFRAMEWORK_WIFICONTROL=y
BR2_PACKAGE_WPEFRAMEWORK_SCREENSAVER=y
# BR2_PACKAGE_WPEFRAMEWORK_SCREENSAVER_AUTOSTART is not set
BR2_PACKAGE_WPEWEBKIT_ML=y
BR2_PACKAGE_WPEWEBKIT_ML_RELEASE=y
BR2_PACKAGE_WPEWEBKIT_ML_WEBRTC=y
BR2_PACKAGE_WPEWEBKIT_ML_WEBDRIVER=y
BR2_PACKAGE_WPEWEBKIT_ML_USE_PUNCH_HOLE_GSTREAMER=y
```

## configs/bpi-m2-zero_lightning_defconfig
```kconfig
BR2_arm=y
BR2_cortex_a7=y
BR2_ARM_FPU_NEON_VFPV4=y
BR2_ARM_INSTRUCTIONS_THUMB2=y
BR2_TOOLCHAIN_EXTERNAL=y
BR2_CCACHE=y
BR2_GLOBAL_PATCH_DIR="$(BR2_EXTERNAL_ML_OSS_PATH)/patches"
BR2_ROOTFS_DEVICE_CREATION_DYNAMIC_EUDEV=y
BR2_TARGET_GENERIC_ROOT_PASSWD="root"
BR2_ROOTFS_OVERLAY=" ${BR2_EXTERNAL_ML_OSS_PATH}/board/bananapi-m2-zero/rootfs-overlay"
BR2_ROOTFS_POST_BUILD_SCRIPT="$(BR2_EXTERNAL_ML_OSS_PATH)/board/bananapi-m2-zero/post-build.sh"
BR2_ROOTFS_POST_IMAGE_SCRIPT="support/scripts/genimage.sh"
BR2_ROOTFS_POST_SCRIPT_ARGS="-c ${BR2_EXTERNAL_ML_OSS_PATH}/board/bananapi-m2-zero/genimage.cfg -- --hdmi-console --install-ssh-id  --ttyS0-console"
BR2_LINUX_KERNEL=y
BR2_LINUX_KERNEL_PATCH=" ${BR2_EXTERNAL_ML_OSS_PATH}/board/bananapi-m2-zero/patches/linux"
BR2_LINUX_KERNEL_USE_CUSTOM_CONFIG=y
BR2_LINUX_KERNEL_CUSTOM_CONFIG_FILE="${BR2_EXTERNAL_ML_OSS_PATH}/board/bananapi-m2-zero/linux-arm_defconfig"
BR2_LINUX_KERNEL_DTS_SUPPORT=y
BR2_LINUX_KERNEL_INTREE_DTS_NAME="allwinner/sun8i-h2-plus-bananapi-m2-zero"
BR2_LINUX_KERNEL_INSTALL_TARGET=y
BR2_LINUX_KERNEL_NEEDS_HOST_OPENSSL=y
BR2_PACKAGE_GST1_PLUGINS_BASE_PLUGIN_APP=y
BR2_PACKAGE_GST1_PLUGINS_BASE_PLUGIN_GIO=y
BR2_PACKAGE_GST1_PLUGINS_BASE_PLUGIN_VIDEORATE=y
BR2_PACKAGE_GST1_PLUGINS_BASE_LIB_OPENGL=y
BR2_PACKAGE_GST1_PLUGINS_BASE_PLUGIN_ALSA=y
BR2_PACKAGE_GST1_PLUGINS_BASE_PLUGIN_TREMOR=y
BR2_PACKAGE_GST1_PLUGINS_BASE_PLUGIN_OGG=y
BR2_PACKAGE_GST1_PLUGINS_BASE_PLUGIN_OPUS=y
BR2_PACKAGE_GST1_PLUGINS_BASE_PLUGIN_VORBIS=y
BR2_PACKAGE_GST1_PLUGINS_GOOD_PLUGIN_AUDIOFX=y
BR2_PACKAGE_GST1_PLUGINS_GOOD_PLUGIN_AUDIOPARSERS=y
BR2_PACKAGE_GST1_PLUGINS_GOOD_PLUGIN_AUTODETECT=y
BR2_PACKAGE_GST1_PLUGINS_GOOD_PLUGIN_DEINTERLACE=y
BR2_PACKAGE_GST1_PLUGINS_GOOD_PLUGIN_ICYDEMUX=y
BR2_PACKAGE_GST1_PLUGINS_GOOD_PLUGIN_ID3DEMUX=y
BR2_PACKAGE_GST1_PLUGINS_GOOD_PLUGIN_INTERLEAVE=y
BR2_PACKAGE_GST1_PLUGINS_GOOD_PLUGIN_MATROSKA=y
BR2_PACKAGE_GST1_PLUGINS_GOOD_PLUGIN_VIDEOCROP=y
BR2_PACKAGE_GST1_PLUGINS_GOOD_PLUGIN_VIDEOFILTER=y
BR2_PACKAGE_GST1_PLUGINS_GOOD_PLUGIN_MPG123=y
BR2_PACKAGE_GST1_PLUGINS_GOOD_PLUGIN_V4L2=y
BR2_PACKAGE_GST1_PLUGINS_GOOD_PLUGIN_V4L2_PROBE=y
BR2_PACKAGE_GST1_PLUGINS_GOOD_PLUGIN_PULSE=y
BR2_PACKAGE_GST1_PLUGINS_GOOD_PLUGIN_SOUPHTTPSRC=y
BR2_PACKAGE_GST1_PLUGINS_GOOD_PLUGIN_VPX=y
BR2_PACKAGE_GST1_PLUGINS_BAD_PLUGIN_MPEGTSDEMUX=y
BR2_PACKAGE_GST1_PLUGINS_BAD_PLUGIN_SUBENC=y
BR2_PACKAGE_GST1_PLUGINS_BAD_PLUGIN_VIDEOPARSERS=y
BR2_PACKAGE_GST1_PLUGINS_BAD_PLUGIN_DASH=y
BR2_PACKAGE_GST1_PLUGINS_BAD_PLUGIN_FAAD=y
BR2_PACKAGE_GST1_PLUGINS_BAD_PLUGIN_FDK_AAC=y
BR2_PACKAGE_GST1_PLUGINS_BAD_PLUGIN_HLS=y
BR2_PACKAGE_GST1_PLUGINS_BAD_PLUGIN_KMS=y
BR2_PACKAGE_GST1_PLUGINS_BAD_PLUGIN_OPENH264=y
BR2_PACKAGE_GST1_PLUGINS_BAD_PLUGIN_OPUS=y
BR2_PACKAGE_GST1_PLUGINS_BAD_PLUGIN_WEBP=y
BR2_PACKAGE_GST1_PLUGINS_BAD_PLUGIN_V4L2CODECS=y
BR2_PACKAGE_XZ=y
BR2_PACKAGE_BITSTREAM_VERA=y
BR2_PACKAGE_MESA3D=y
BR2_PACKAGE_MESA3D_GALLIUM_DRIVER_LIMA=y
BR2_PACKAGE_MESA3D_OPENGL_EGL=y
BR2_PACKAGE_MESA3D_OPENGL_ES=y
BR2_PACKAGE_LINUX_FIRMWARE=y
BR2_PACKAGE_LINUX_FIRMWARE_BRCM_BCM43XXX=y
BR2_PACKAGE_LIBXCRYPT=y
BR2_PACKAGE_LIBV4L=y
BR2_PACKAGE_C_ARES=y
BR2_PACKAGE_LIBCURL=y
BR2_PACKAGE_LIBCURL_CURL=y
BR2_PACKAGE_LIBSOUP3=y
BR2_PACKAGE_LIBSOUP3_SSL=y
BR2_PACKAGE_ORC=y
BR2_PACKAGE_SHARED_MIME_INFO=y
BR2_PACKAGE_DROPBEAR=y
BR2_PACKAGE_RSYNC=y
BR2_PACKAGE_WPA_SUPPLICANT_AP_SUPPORT=y
BR2_PACKAGE_WPA_SUPPLICANT_WPS=y
BR2_PACKAGE_WPA_SUPPLICANT_CTRL_IFACE=y
BR2_PACKAGE_UTIL_LINUX_LIBMOUNT=y
BR2_TARGET_ROOTFS_EXT2=y
BR2_TARGET_ROOTFS_EXT2_4=y
BR2_TARGET_ROOTFS_EXT2_SIZE="200M"
# BR2_TARGET_ROOTFS_TAR is not set
BR2_TARGET_UBOOT=y
BR2_TARGET_UBOOT_BOARDNAME="bananapi_m2_zero"
BR2_TARGET_UBOOT_CUSTOM_VERSION=y
BR2_TARGET_UBOOT_CUSTOM_VERSION_VALUE="2024.01"
BR2_TARGET_UBOOT_NEEDS_DTC=y
BR2_TARGET_UBOOT_NEEDS_PYLIBFDT=y
BR2_TARGET_UBOOT_FORMAT_CUSTOM=y
BR2_TARGET_UBOOT_FORMAT_CUSTOM_NAME="u-boot-sunxi-with-spl.bin"
BR2_PACKAGE_HOST_DOSFSTOOLS=y
BR2_PACKAGE_HOST_GENIMAGE=y
BR2_PACKAGE_HOST_MTOOLS=y
BR2_PACKAGE_GST1_PLUGINS_BASE_LIB_OPENGL_LIBEGL=y
BR2_PACKAGE_BLITS_EXAMPLE_APP=y
BR2_PACKAGE_THUNDER_MESSAGING=y
BR2_PACKAGE_THUNDER_CLIENTLIBRARY_DISPLAYINFO=y
BR2_PACKAGE_THUNDER_CLIENTLIBRARY_CRYPTOGRAPHY=y
BR2_PACKAGE_THUNDER_BLUETOOTH=y
BR2_PACKAGE_THUNDER_COMPOSITOR=y
BR2_PACKAGE_THUNDER_COMPOSITOR_EXPERIMENTAL=y
BR2_PACKAGE_THUNDER_DEVICEINFO=y
BR2_PACKAGE_THUNDER_DHCPSERVER=y
BR2_PACKAGE_THUNDER_LOCATIONSYNC=y
BR2_PACKAGE_THUNDER_MESSAGECONTROL=y
BR2_PACKAGE_THUNDER_MONITOR=y
BR2_PACKAGE_THUNDER_REMOTECONTROL=y
BR2_PACKAGE_THUNDER_REMOTECONTROL_DEVINPUT=y
BR2_PACKAGE_THUNDER_SUBSYSTEMCONTROLLER=y
BR2_PACKAGE_THUNDER_TIMESYNC=y
BR2_PACKAGE_THUNDER_WEBKITBROWSER=y
BR2_PACKAGE_THUNDER_WEBKITBROWSER_STARTURL="https://blits-demo.lightningjs.io"
BR2_PACKAGE_THUNDER_WEBKITBROWSER_MEMORYPRESSURE="databaseprocess:50m,networkprocess:80m,webprocess:250m,rpcprocess:80m"
BR2_PACKAGE_THUNDER_WEBKITBROWSER_DISKCACHE="512m"
BR2_PACKAGE_THUNDER_WEBKITBROWSER_XHRCACHE=y
BR2_PACKAGE_THUNDER_WEBKITBROWSER_THREADEDPAINTING="2"
BR2_PACKAGE_THUNDER_WEBSERVER=y
BR2_PACKAGE_THUNDER_WIFICONTROL=y
BR2_PACKAGE_WPEWEBKIT_ML=y
BR2_PACKAGE_WPEWEBKIT_ML_WEBRTC=y
BR2_PACKAGE_WPEWEBKIT_ML_WEBDRIVER=y
```
